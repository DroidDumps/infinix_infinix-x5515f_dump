/dts-v1/;

/ {
	#address-cells = <0x02>;
	#size-cells = <0x02>;
	compatible = "mediatek,mt6739";
	interrupt-parent = <0x01>;
	model = "mt6739";

	__symbols__ {
		DPIDLE = "/cpus/idle-states/dpidle";
		MCDI_CLUSTER = "/cpus/idle-states/mcdi-cluster";
		MCDI_CPU = "/cpus/idle-states/mcdi-cpu";
		SODI = "/cpus/idle-states/sodi";
		SODI3 = "/cpus/idle-states/sodi3";
		STANDBY = "/cpus/idle-states/standby";
		SUSPEND = "/cpus/idle-states/suspend";
		accdet = "/accdet";
		als = "/als_ps@0";
		apmixed = "/apmixed@1000c000";
		apuart0 = "/apuart0@11002000";
		apuart1 = "/apuart1@11003000";
		audgpio = "/mt_soc_dl1_pcm@11220000";
		audio = "/audio@11220000";
		auxadc = "/auxadc@11001000";
		bat_gm30 = "/battery";
		cam_cal_drv_s5k3l8_eeprom = "/cam_cal_drv_s5k3l8_eeprom";
		charger = "/charger";
		chosen = "/chosen";
		chr_stat = "/chr_stat";
		clk26m = "/clk26m";
		clk32k = "/clk32k";
		consys = "/consys@18070000";
		cpu0 = "/cpus/cpu@0";
		cpu1 = "/cpus/cpu@001";
		cpu2 = "/cpus/cpu@002";
		cpu3 = "/cpus/cpu@003";
		cpu_dbgapb = "/cpu_dbgapb";
		disp_aal0 = "/disp_aal0@1400f000";
		disp_mutex = "/disp_mutex@14001000";
		disp_ovl0 = "/disp_ovl0@1400a000";
		dispsys = "/dispsys@14000000";
		dsi_te = "/dsi_te";
		flashlight_core = "/flashlight_core";
		flashlights_aw3644 = "/flashlights_aw3644";
		flashlights_dio5644 = "/flashlights_dio5644";
		gic = "/interrupt-controller@0c000000";
		goodix_fp = "/fingerprint";
		gpio = "/gpio@10005000";
		gpio_usage_mapping = "/gpio";
		gse_1 = "/gse_1";
		gyro = "/gyro";
		i2c0 = "/i2c@11007000";
		i2c1 = "/i2c@11008000";
		i2c2 = "/i2c@11009000";
		i2c3 = "/i2c@1100f000";
		i2c4 = "/i2c@11011000";
		i2c5 = "/i2c@11016000";
		imgsys_config = "/imgsys_config@15000000";
		infracfg_ao = "/infracfg_ao@10001000";
		irq_nfc = "/irq_nfc";
		irtx_pwm = "/irtx_pwm";
		kd_camera_hw1 = "/kd_camera_hw1@15008000";
		keypad = "/kp@10010000";
		main_pmic = "/pwrap@1000d000/pmic_irq";
		md1_sim1_hot_plug_eint = "/md1_sim1_hot_plug_eint";
		md1_sim2_hot_plug_eint = "/md1_sim2_hot_plug_eint";
		mdcldma = "/mdcldma@10014000";
		mdp_rdma0 = "/mdp_rdma0@14004000";
		mdp_rsz0 = "/mdp_rsz0@14005000";
		mdp_rsz1 = "/mdp_rsz1@14006000";
		mdp_tdshp0 = "/mdp_tdshp0@14009000";
		mdp_wdma0 = "/mdp_wdma0@14007000";
		mdp_wrot0 = "/mdp_wrot0@14008000";
		mm_mutex = "/mm_mutex@14016000";
		mmsys_config = "/mmsys_config@14000000";
		mrdump_ext_rst = "/mrdump_ext_rst";
		msdc0 = "/msdc@11230000";
		msdc0_pins_default = "/msdc@11230000/msdc0@default";
		msdc0_register_setting_default = "/msdc@11230000/msdc0@register_default";
		msdc1 = "/msdc@11240000";
		msdc1_ins = "/msdc1_ins";
		msdc1_pins_ddr50 = "/msdc@11240000/msdc1@ddr50";
		msdc1_pins_default = "/msdc@11240000/msdc1@default";
		msdc1_pins_sdr104 = "/msdc@11240000/msdc1@sdr104";
		msdc1_pins_sdr50 = "/msdc@11240000/msdc1@sdr50";
		msdc1_register_setting_default = "/msdc@11240000/msdc1@register_default";
		mse = "/mse";
		mt_charger = "/mt_charger";
		mt_pmic_vaud28_ldo_reg = "/mt_pmic_regulator/ldo_regulators/ldo_vaud28";
		mt_pmic_vaux18_ldo_reg = "/mt_pmic_regulator/ldo_regulators/ldo_vaux18";
		mt_pmic_vcama_ldo_reg = "/mt_pmic_regulator/ldo_regulators/ldo_vcama";
		mt_pmic_vcamd_ldo_reg = "/mt_pmic_regulator/ldo_regulators/ldo_vcamd";
		mt_pmic_vcamio_ldo_reg = "/mt_pmic_regulator/ldo_regulators/ldo_vcamio";
		mt_pmic_vcn18_ldo_reg = "/mt_pmic_regulator/ldo_regulators/ldo_vcn18";
		mt_pmic_vcn28_ldo_reg = "/mt_pmic_regulator/ldo_regulators/ldo_vcn28";
		mt_pmic_vcn33_bt_ldo_reg = "/mt_pmic_regulator/ldo_regulators/ldo_vcn33_bt";
		mt_pmic_vcn33_wifi_ldo_reg = "/mt_pmic_regulator/ldo_regulators/ldo_vcn33_wifi";
		mt_pmic_vcore_buck_reg = "/mt_pmic_regulator/buck_regulators/buck_vcore";
		mt_pmic_vdram_ldo_reg = "/mt_pmic_regulator/ldo_regulators/ldo_vdram";
		mt_pmic_vefuse_ldo_reg = "/mt_pmic_regulator/ldo_regulators/ldo_vefuse";
		mt_pmic_vemc_ldo_reg = "/mt_pmic_regulator/ldo_regulators/ldo_vemc";
		mt_pmic_vfe28_ldo_reg = "/mt_pmic_regulator/ldo_regulators/ldo_vfe28";
		mt_pmic_vibr_ldo_reg = "/mt_pmic_regulator/ldo_regulators/ldo_vibr";
		mt_pmic_vio18_ldo_reg = "/mt_pmic_regulator/ldo_regulators/ldo_vio18";
		mt_pmic_vio28_ldo_reg = "/mt_pmic_regulator/ldo_regulators/ldo_vio28";
		mt_pmic_vldo28_ldo_reg = "/mt_pmic_regulator/ldo_regulators/ldo_vldo28";
		mt_pmic_vmc_ldo_reg = "/mt_pmic_regulator/ldo_regulators/ldo_vmc";
		mt_pmic_vmch_ldo_reg = "/mt_pmic_regulator/ldo_regulators/ldo_vmch";
		mt_pmic_vmodem_buck_reg = "/mt_pmic_regulator/buck_regulators/buck_vmodem";
		mt_pmic_vpa_buck_reg = "/mt_pmic_regulator/buck_regulators/buck_vpa";
		mt_pmic_vproc_buck_reg = "/mt_pmic_regulator/buck_regulators/buck_vproc";
		mt_pmic_vrf12_ldo_reg = "/mt_pmic_regulator/ldo_regulators/ldo_vrf12";
		mt_pmic_vrf18_ldo_reg = "/mt_pmic_regulator/ldo_regulators/ldo_vrf18";
		mt_pmic_vs1_buck_reg = "/mt_pmic_regulator/buck_regulators/buck_vs1";
		mt_pmic_vsim1_ldo_reg = "/mt_pmic_regulator/ldo_regulators/ldo_vsim1";
		mt_pmic_vsim2_ldo_reg = "/mt_pmic_regulator/ldo_regulators/ldo_vsim2";
		mt_pmic_vsram_others_ldo_reg = "/mt_pmic_regulator/ldo_regulators/ldo_vsram_others";
		mt_pmic_vsram_proc_ldo_reg = "/mt_pmic_regulator/ldo_regulators/ldo_vsram_proc";
		mt_pmic_vusb33_ldo_reg = "/mt_pmic_regulator/ldo_regulators/ldo_vusb33";
		mt_pmic_vxo22_ldo_reg = "/mt_pmic_regulator/ldo_regulators/ldo_vxo22";
		mtkfb = "/mtkfb";
		nfc = "/nfc";
		odm = "/odm";
		otg_iddig = "/otg_iddig";
		pio = "/pinctrl@1000b000";
		pmic_clock_buffer_ctrl = "/pmic_clock_buffer_ctrl";
		reserved_memory = "/reserved-memory";
		rt9465_slave_chr = "/rt9465_slave_chr";
		scpsys = "/scpsys@10001000";
		smi_larb0 = "/smi_larb0@14003000";
		smi_larb1 = "/smi_larb1@17010000";
		smi_larb2 = "/smi_larb2@15001000";
		spi0 = "/spi@1100a000";
		spi1 = "/spi@11010000";
		spi2 = "/spi@11012000";
		syscfg_pctl_a = "/syscfg_pctl_a@10005000";
		syscfg_pctl_bl = "/syscfg_pctl_bl@10002600";
		syscfg_pctl_bm = "/syscfg_pctl_bm@10002800";
		syscfg_pctl_lb = "/syscfg_pctl_lb@10002400";
		syscfg_pctl_lm = "/syscfg_pctl_lm@10002200";
		syscfg_pctl_lt = "/syscfg_pctl_lt@10002000";
		syscfg_pctl_rb = "/syscfg_pctl_rb@10002a00";
		syscfg_pctl_rt = "/syscfg_pctl_bl@10002c00";
		sysirq = "/intpol-controller@0x10200620";
		topckgen = "/topckgen@10000000";
		touch = "/touch";
		venc = "/venc@17020000";
		venc_global_con = "/venc_global_con@17000000";
	};

	accdet {
		compatible = "mediatek,pmic-accdet";
		linux,phandle = <0x3d>;
		phandle = <0x3d>;
	};

	aes_top0@10016000 {
		compatible = "mediatek,aes_top0";
		reg = <0x00 0x10016000 0x00 0x1000>;
	};

	als_ps@0 {
		compatible = "mediatek,als_ps";
		linux,phandle = <0x5e>;
		phandle = <0x5e>;
	};

	amms_control {
		compatible = "mediatek,amms";
		interrupts = <0x00 0x7b 0x01>;
	};

	ap_ccif0@10209000 {
		compatible = "mediatek,ap_ccif0";
		interrupts = <0x00 0x94 0x08>;
		reg = <0x00 0x10209000 0x00 0x1000>;
	};

	ap_ccif1@1020b000 {
		compatible = "mediatek,ap_ccif1";
		interrupts = <0x00 0x96 0x08>;
		reg = <0x00 0x1020b000 0x00 0x1000>;
	};

	ap_dma@11000000 {
		compatible = "mediatek,ap_dma";
		interrupts = <0x00 0x52 0x08>;
		reg = <0x00 0x11000000 0x00 0x1000>;
	};

	apcldmain@1021b000 {
		compatible = "mediatek,apcldmain";
		reg = <0x00 0x1021b000 0x00 0x00>;
	};

	apcldmain@1021b100 {
		compatible = "mediatek,apcldmain";
		reg = <0x00 0x1021b100 0x00 0x00>;
	};

	apcldmain_ao@10014000 {
		compatible = "mediatek,apcldmain_ao";
		reg = <0x00 0x10014000 0x00 0x400>;
	};

	apcldmamisc@1021b800 {
		compatible = "mediatek,apcldmamisc";
		interrupts = <0x00 0xa5 0x04>;
		reg = <0x00 0x1021b800 0x00 0x00>;
	};

	apcldmamisc@1021b900 {
		compatible = "mediatek,apcldmamisc";
		reg = <0x00 0x1021b900 0x00 0x400>;
	};

	apcldmamisc_ao@10014800 {
		compatible = "mediatek,apcldmamisc_ao";
		reg = <0x00 0x10014800 0x00 0x400>;
	};

	apcldmamisc_ao@10014c00 {
		compatible = "mediatek,apcldmamisc_ao";
		reg = <0x00 0x10014c00 0x00 0x400>;
	};

	apcldmaout@1021b400 {
		compatible = "mediatek,apcldmaout";
		reg = <0x00 0x1021b400 0x00 0x00>;
	};

	apcldmaout@1021b500 {
		compatible = "mediatek,apcldmaout";
		reg = <0x00 0x1021b500 0x00 0x00>;
	};

	apcldmaout_ao@10014400 {
		compatible = "mediatek,apcldmaout_ao";
		reg = <0x00 0x10014400 0x00 0x400>;
	};

	apmixed@1000c000 {
		#clock-cells = <0x01>;
		compatible = "mediatek,apmixed\0mediatek,apmixedsys\0syscon";
		linux,phandle = <0x32>;
		phandle = <0x32>;
		reg = <0x00 0x1000c000 0x00 0x1000>;
	};

	apuart0@11002000 {
		cell-index = <0x00>;
		clock-div = <0x01>;
		clock-frequency = <0x18cba80>;
		clock-names = "uart0-main\0uart-apdma";
		clocks = <0x19 0x14 0x19 0x28>;
		compatible = "mediatek,mtk-uart";
		interrupts = <0x00 0x5b 0x08 0x00 0x68 0x08 0x00 0x69 0x08>;
		linux,phandle = <0x40>;
		phandle = <0x40>;
		reg = <0x00 0x11002000 0x00 0x1000 0x00 0x11000400 0x00 0x80 0x00 0x11000480 0x00 0x80>;
	};

	apuart1@11003000 {
		cell-index = <0x01>;
		clock-div = <0x01>;
		clock-frequency = <0x18cba80>;
		clock-names = "uart1-main";
		clocks = <0x19 0x15>;
		compatible = "mediatek,mtk-uart";
		interrupts = <0x00 0x5c 0x08 0x00 0x6a 0x08 0x00 0x6b 0x08>;
		linux,phandle = <0x41>;
		phandle = <0x41>;
		reg = <0x00 0x11003000 0x00 0x1000 0x00 0x11000500 0x00 0x80 0x00 0x11000580 0x00 0x80>;
	};

	apxgpt@10008000 {
		clocks = <0x18>;
		compatible = "mediatek,apxgpt";
		interrupts = <0x00 0xa6 0x08>;
		reg = <0x00 0x10008000 0x00 0x1000>;
	};

	atf_logger {
		compatible = "mediatek,atf_logger";
		interrupts = <0x00 0xf1 0x01>;
	};

	audio@11220000 {
		#clock-cells = <0x01>;
		compatible = "mediatek,audio\0syscon";
		linux,phandle = <0x31>;
		phandle = <0x31>;
		reg = <0x00 0x11220000 0x00 0x1000>;
	};

	audio_sram@11221000 {
		compatible = "mediatek,audio_sram";
		reg = <0x00 0x11221000 0x00 0x9000>;
	};

	auxadc@11001000 {
		clock-names = "auxadc-main";
		clocks = <0x19 0x22>;
		compatible = "mediatek,auxadc";
		interrupts = <0x00 0x4a 0x02>;
		linux,phandle = <0x3f>;
		phandle = <0x3f>;
		reg = <0x00 0x11001000 0x00 0x1000>;
	};

	battery {
		CAR_TUNE_VALUE = <0x64>;
		DIFFERENCE_FULLOCV_ITH = <0x96>;
		EMBEDDED_SEL = <0x01>;
		FG_METER_RESISTANCE = <0xc8>;
		KEEP_100_PERCENT = <0x03>;
		PMIC_SHUTDOWN_CURRENT = <0x14>;
		Q_MAX_SYS_VOLTAGE_BAT0 = <0xd48>;
		Q_MAX_SYS_VOLTAGE_BAT1 = <0xd48>;
		Q_MAX_SYS_VOLTAGE_BAT2 = <0xd48>;
		Q_MAX_SYS_VOLTAGE_BAT3 = <0xd48>;
		R_FG_VALUE = <0x0a>;
		SHUTDOWN_1_TIME = <0x3c>;
		TEMPERATURE_T0 = <0x32>;
		TEMPERATURE_T1 = <0x19>;
		TEMPERATURE_T2 = <0x0a>;
		TEMPERATURE_T3 = <0x00>;
		TEMPERATURE_T4 = <0xfffffff6>;
		bat_id_gpio = <0x2e 0x0f 0x00>;
		battery0_profile_t0 = <0x00 0xaaf0 0x4fb 0x12d 0xaa5a 0x4fb 0x25a 0xa9d8 0x4fb 0x387 0xa960 0x4e2 0x4b4 0xa8e8 0x4e2 0x5e1 0xa870 0x4e2 0x70e 0xa802 0x4e2 0x83b 0xa78a 0x4e2 0x968 0xa712 0x4e2 0xa95 0xa6a4 0x4fb 0xbc2 0xa62c 0x4e2 0xcef 0xa5b4 0x4e2 0xe1c 0xa546 0x4fb 0xf49 0xa4ce 0x4e2 0x1076 0xa460 0x4fb 0x11a3 0xa3f2 0x4fb 0x12d0 0xa37a 0x4fb 0x13fd 0xa30c 0x4fb 0x152a 0xa29e 0x514 0x1657 0xa230 0x514 0x1784 0xa1c2 0x514 0x18b1 0xa154 0x514 0x19de 0xa0e6 0x514 0x1b0b 0xa082 0x514 0x1c38 0xa014 0x514 0x1d65 0x9fb0 0x52d 0x1e92 0x9f42 0x514 0x1fbf 0x9ede 0x52d 0x20ec 0x9e84 0x546 0x2219 0x9e2a 0x55f 0x2346 0x9dc6 0x55f 0x2473 0x9d62 0x55f 0x25a0 0x9cfe 0x55f 0x26cd 0x9ca4 0x55f 0x27fa 0x9c4a 0x55f 0x2927 0x9c04 0x591 0x2a54 0x9baa 0x591 0x2b81 0x9b5a 0x5aa 0x2cae 0x9b00 0x5aa 0x2ddb 0x9ab0 0x5c3 0x2f08 0x9a60 0x5c3 0x3035 0x9a10 0x5dc 0x3162 0x99b6 0x5dc 0x328f 0x9948 0x5aa 0x33bc 0x98c6 0x55f 0x34e9 0x9844 0x52d 0x3616 0x97e0 0x514 0x3743 0x9790 0x4fb 0x3870 0x974a 0x4fb 0x399d 0x9704 0x4e2 0x3aca 0x96c8 0x4e2 0x3bf7 0x9696 0x4fb 0x3d24 0x965a 0x4e2 0x3e51 0x9628 0x4fb 0x3f7e 0x95f6 0x4fb 0x40ab 0x95ce 0x4fb 0x41d8 0x959c 0x4fb 0x4305 0x9574 0x514 0x4432 0x954c 0x514 0x455f 0x9524 0x52d 0x468c 0x94fc 0x52d 0x47b9 0x94d4 0x52d 0x48e6 0x94ac 0x52d 0x4a13 0x948e 0x52d 0x4b40 0x9470 0x546 0x4c6d 0x9452 0x546 0x4d9a 0x9434 0x55f 0x4ec7 0x9416 0x55f 0x4ff4 0x93f8 0x55f 0x5121 0x93da 0x578 0x524e 0x93bc 0x578 0x537b 0x939e 0x578 0x54a8 0x9362 0x546 0x55d5 0x9312 0x4fb 0x5702 0x92d6 0x514 0x582f 0x92a4 0x514 0x595c 0x927c 0x514 0x5a89 0x9254 0x514 0x5bb6 0x922c 0x52d 0x5ce3 0x91fa 0x514 0x5e10 0x91dc 0x52d 0x5f3d 0x91b4 0x514 0x606a 0x9196 0x52d 0x6197 0x916e 0x52d 0x62c4 0x913c 0x52d 0x63f1 0x9100 0x52d 0x651e 0x90c4 0x52d 0x664b 0x9092 0x52d 0x6778 0x9056 0x546 0x68a5 0x8ffc 0x514 0x69d2 0x8fd4 0x4fb 0x6aff 0x8fca 0x514 0x6c2c 0x8fc0 0x546 0x6d59 0x8fb6 0x55f 0x6e86 0x8fa2 0x578 0x6fb3 0x8f84 0x5c3 0x70e0 0x8f02 0x591 0x720d 0x8db8 0x578 0x733a 0x8bf6 0x5aa 0x7467 0x84d0 0x5dc>;
		battery0_profile_t0_num = <0x64>;
		battery0_profile_t1 = <0x00 0xab40 0x7b7 0x12c 0xaaaa 0x7b7 0x258 0xaa28 0x79e 0x384 0xa9b0 0x785 0x4b0 0xa938 0x785 0x5dc 0xa8c0 0x76c 0x708 0xa848 0x76c 0x834 0xa7d0 0x785 0x960 0xa758 0x76c 0xa8c 0xa6e0 0x785 0xbb8 0xa672 0x79e 0xce4 0xa5fa 0x785 0xe10 0xa582 0x785 0xf3c 0xa50a 0x785 0x1068 0xa492 0x76c 0x1194 0xa424 0x785 0x12c0 0xa3b6 0x785 0x13ec 0xa33e 0x76c 0x1518 0xa2d0 0x79e 0x1644 0xa262 0x785 0x1770 0xa1f4 0x76c 0x189c 0xa186 0x76c 0x19c8 0xa118 0x7b7 0x1af4 0xa0aa 0x79e 0x1c20 0xa046 0x79e 0x1d4c 0x9fd8 0x7b7 0x1e78 0x9f74 0x7b7 0x1fa4 0x9f24 0x7d0 0x20d0 0x9ec0 0x7d0 0x21fc 0x9e5c 0x81b 0x2328 0x9dee 0x81b 0x2454 0x9d80 0x802 0x2580 0x9d12 0x802 0x26ac 0x9cae 0x81b 0x27d8 0x9c4a 0x802 0x2904 0x9bf0 0x81b 0x2a30 0x9ba0 0x84d 0x2b5c 0x9b50 0x834 0x2c88 0x9b00 0x81b 0x2db4 0x9aba 0x84d 0x2ee0 0x9a6a 0x84d 0x300c 0x9a06 0x834 0x3138 0x9998 0x802 0x3264 0x992a 0x7d0 0x3390 0x98b2 0x785 0x34bc 0x983a 0x721 0x35e8 0x97d6 0x6ef 0x3714 0x9786 0x6ef 0x3840 0x9740 0x6ef 0x396c 0x96fa 0x6d6 0x3a98 0x96c8 0x6d6 0x3bc4 0x968c 0x6ef 0x3cf0 0x965a 0x708 0x3e1c 0x961e 0x6ef 0x3f48 0x95ec 0x6ef 0x4074 0x95c4 0x6ef 0x41a0 0x9592 0x6d6 0x42cc 0x956a 0x6ef 0x43f8 0x9542 0x708 0x4524 0x9524 0x73a 0x4650 0x94f2 0x721 0x477c 0x94d4 0x721 0x48a8 0x94ac 0x721 0x49d4 0x948e 0x721 0x4b00 0x9470 0x753 0x4c2c 0x9452 0x76c 0x4d58 0x9434 0x76c 0x4e84 0x9420 0x76c 0x4fb0 0x9402 0x76c 0x50dc 0x93ee 0x785 0x5208 0x93c6 0x76c 0x5334 0x93a8 0x76c 0x5460 0x938a 0x753 0x558c 0x936c 0x753 0x56b8 0x934e 0x73a 0x57e4 0x9326 0x753 0x5910 0x9308 0x753 0x5a3c 0x92e0 0x753 0x5b68 0x92b8 0x753 0x5c94 0x9290 0x753 0x5dc0 0x9272 0x753 0x5eec 0x9254 0x76c 0x6018 0x9236 0x79e 0x6144 0x9204 0x79e 0x6270 0x91d2 0x79e 0x639c 0x918c 0x785 0x64c8 0x915a 0x79e 0x65f4 0x9128 0x7d0 0x6720 0x90d8 0x7d0 0x684c 0x9088 0x7e9 0x6978 0x9056 0x7d0 0x6aa4 0x904c 0x802 0x6bd0 0x9038 0x81b 0x6cfc 0x902e 0x87f 0x6e28 0x901a 0x8fc 0x6f54 0x8ffc 0x979 0x7080 0x8f84 0x9ab 0x71ac 0x8e3a 0x979 0x72d8 0x8c46 0x9dd 0x7404 0x84d0 0xabe>;
		battery0_profile_t1_num = <0x64>;
		battery0_profile_t2 = <0x00 0xab54 0xf0a 0x12c 0xaabe 0xf0a 0x258 0xaa3c 0xef1 0x384 0xa9c4 0xebf 0x4b0 0xa956 0xea6 0x5dc 0xa8de 0xe8d 0x709 0xa866 0xe5b 0x836 0xa7ee 0xe29 0x963 0xa780 0xe29 0xa90 0xa708 0xdde 0xbbd 0xa69a 0xdde 0xcea 0xa622 0xdac 0xe17 0xa5b4 0xd93 0xf44 0xa53c 0xd61 0x1071 0xa4ce 0xd2f 0x119e 0xa456 0xd16 0x12cb 0xa3e8 0xcfd 0x13f8 0xa37a 0xce4 0x1525 0xa30c 0xce4 0x1651 0xa29e 0xccb 0x177d 0xa230 0xccb 0x18a9 0xa1c2 0xcb2 0x19d5 0xa15e 0xcb2 0x1b01 0xa0f0 0xcb2 0x1c2d 0xa082 0xc99 0x1d59 0xa01e 0xc80 0x1e85 0x9fba 0xc99 0x1fb1 0x9f6a 0xccb 0x20dd 0x9f10 0xce4 0x220a 0x9eac 0xcfd 0x2337 0x9e48 0xd16 0x2464 0x9dc6 0xce4 0x2591 0x9d3a 0xcb2 0x26bd 0x9cb8 0xc80 0x27e9 0x9c4a 0xc80 0x2915 0x9be6 0xc67 0x2a42 0x9ba0 0xc80 0x2b6f 0x9b50 0xc67 0x2c9b 0x9b00 0xc67 0x2dc8 0x9aa6 0xc35 0x2ef5 0x9a4c 0xc1c 0x3022 0x99f2 0xc03 0x314e 0x998e 0xbd1 0x327a 0x9920 0xb86 0x34d3 0x9858 0xb22 0x35ff 0x97fe 0xaf0 0x372c 0x97ae 0xad7 0x3858 0x9768 0xad7 0x3984 0x9722 0xabe 0x3ab0 0x96e6 0xabe 0x3bdc 0x96aa 0xabe 0x3d08 0x966e 0xabe 0x3e34 0x963c 0xabe 0x3f61 0x960a 0xabe 0x408d 0x95d8 0xabe 0x41b9 0x95b0 0xad7 0x42e6 0x957e 0xad7 0x4413 0x9556 0xaf0 0x4540 0x952e 0xaf0 0x466d 0x9506 0xaf0 0x479a 0x94e8 0xb09 0x48c7 0x94c0 0xb09 0x49f4 0x94a2 0xb22 0x4b21 0x9484 0xb3b 0x4c4e 0x945c 0xb3b 0x4d7b 0x943e 0xb3b 0x4ea8 0x942a 0xb54 0x4fd5 0x940c 0xb6d 0x5102 0x93ee 0xb6d 0x522f 0x93da 0xb6d 0x535c 0x93c6 0xb86 0x5489 0x93b2 0xb9f 0x55b6 0x939e 0xb9f 0x56e3 0x938a 0xbb8 0x580f 0x9376 0xbd1 0x593b 0x9358 0xbea 0x5a67 0x933a 0xbea 0x5b94 0x9312 0xc03 0x5cc1 0x92f4 0xc1c 0x5ded 0x92cc 0xc35 0x5f1a 0x92ae 0xc67 0x6046 0x9286 0xc99 0x6172 0x925e 0xce4 0x629f 0x922c 0xd16 0x63cc 0x91f0 0xd48 0x64f9 0x91b4 0xd93 0x6625 0x9182 0xdde 0x6751 0x9146 0xe42 0x687d 0x90f6 0xe8d 0x69a9 0x90a6 0xef1 0x6ad5 0x907e 0xf87 0x6c01 0x9060 0x101d 0x6d2d 0x904c 0x10fe 0x6e59 0x9038 0x1211 0x6f86 0x901a 0x136f 0x70b3 0x8fe8 0x1531 0x71e0 0x8f5c 0x16f3 0x730d 0x8dfe 0x1883 0x7439 0x8c0a 0x1b8a 0x7565 0x84d0 0x2021>;
		battery0_profile_t2_num = <0x64>;
		battery0_profile_t3 = <0x00 0xabc2 0x2008 0x12d 0xaa96 0x2008 0x25a 0xaa00 0x2008 0x387 0xa96a 0x1fbd 0x4b4 0xa8e8 0x1f72 0x5e1 0xa866 0x1f27 0x70e 0xa7e4 0x1ec3 0x83b 0xa76c 0x1e78 0x968 0xa6f4 0x1e2d 0xa95 0xa67c 0x1dc9 0xbc2 0xa604 0x1d7e 0xcef 0xa596 0x1d33 0xe1c 0xa51e 0x1ccf 0xf49 0xa4b0 0x1c9d 0x1076 0xa442 0x1c6b 0x11a3 0xa3d4 0x1c20 0x12d0 0xa366 0x1bd5 0x13fd 0xa2f8 0x1ba3 0x152a 0xa28a 0x1b71 0x1657 0xa21c 0x1b3f 0x1784 0xa1ae 0x1af4 0x18b1 0xa14a 0x1adb 0x19de 0xa0dc 0x1aa9 0x1b0b 0xa078 0x1a90 0x1c38 0xa014 0x1a5e 0x1d65 0x9fba 0x1a77 0x1e92 0x9f6a 0x1a77 0x1fbf 0x9f06 0x1a5e 0x20ec 0x9ea2 0x1a5e 0x2219 0x9e20 0x1a2c 0x2346 0x9d94 0x19c8 0x2473 0x9cfe 0x1964 0x25a0 0x9c72 0x1900 0x26cd 0x9bfa 0x18e7 0x27fa 0x9b8c 0x18ce 0x2927 0x9b32 0x18b5 0x2a54 0x9ad8 0x189c 0x2cae 0x9a38 0x1851 0x2ddb 0x99de 0x181f 0x2f08 0x998e 0x1806 0x3035 0x9934 0x17bb 0x3162 0x98e4 0x17bb 0x328f 0x988a 0x1789 0x33bc 0x9830 0x1757 0x34e9 0x97e0 0x173e 0x3616 0x9790 0x1725 0x3743 0x974a 0x1725 0x3870 0x9704 0x1725 0x399d 0x96c8 0x1725 0x3aca 0x968c 0x173e 0x3bf7 0x9650 0x1725 0x3d24 0x961e 0x173e 0x3e51 0x95ec 0x1757 0x3f7e 0x95ba 0x1770 0x40ab 0x9588 0x1789 0x41d8 0x9560 0x17bb 0x4305 0x952e 0x17bb 0x4432 0x9506 0x17ed 0x455f 0x94de 0x1806 0x468c 0x94c0 0x1838 0x47b9 0x9498 0x1851 0x48e6 0x947a 0x1883 0x4a13 0x9452 0x18b5 0x4b40 0x9434 0x18ce 0x4c6d 0x9420 0x1900 0x4d9a 0x940c 0x194b 0x4ec7 0x93f8 0x1996 0x4ff4 0x93ee 0x19fa 0x5121 0x93da 0x1a45 0x524e 0x93c6 0x1a90 0x537b 0x93bc 0x1b0d 0x54a8 0x93a8 0x1b8a 0x55d5 0x9394 0x1c07 0x5702 0x9380 0x1c84 0x582f 0x936c 0x1d1a 0x595c 0x9358 0x1d97 0x5a89 0x933a 0x1e2d 0x5bb6 0x931c 0x1edc 0x5ce3 0x92fe 0x1f8b 0x5e10 0x92d6 0x203a 0x5f3d 0x92b8 0x211b 0x606a 0x9286 0x21fc 0x6197 0x925e 0x22f6 0x62c4 0x922c 0x23f0 0x63f1 0x91f0 0x2503 0x651e 0x91b4 0x2661 0x664b 0x916e 0x27a6 0x6778 0x9132 0x294f 0x68a5 0x90ec 0x2b2a 0x69d2 0x90b0 0x2d1e 0x6aff 0x9074 0x2f5d 0x6c2c 0x904c 0x31ce 0x6d59 0x902e 0x3471 0x6e86 0x9006 0x372d 0x6fb3 0x8fd4 0x39e9 0x70e0 0x8f84 0x3ca5 0x720d 0x8f02 0x3f48 0x733a 0x8df4 0x4204 0x7467 0x8c3c 0x4605 0x7594 0x84d0 0x4c2c>;
		battery0_profile_t3_num = <0x64>;
		battery0_profile_t4 = <0x00 0xab72 0x3471 0x12d 0xaa82 0x3471 0x25a 0xa9ba 0x33db 0x387 0xa910 0x32fa 0x4b4 0xa866 0x3219 0x5e1 0xa7d0 0x31ce 0x70e 0xa73a 0x319c 0x83b 0xa6ae 0x31b5 0x968 0xa62c 0x31ce 0xa95 0xa5aa 0x3183 0xbc2 0xa528 0x30bb 0xcef 0xa4b0 0x2fc1 0xe1c 0xa438 0x2ef9 0xf49 0xa3ca 0x2e18 0x1076 0xa352 0x2d50 0x11a3 0xa2e4 0x2cec 0x12d0 0xa26c 0x2cd3 0x13fd 0xa1fe 0x2d05 0x152a 0xa190 0x2d50 0x1657 0xa122 0x2d69 0x1784 0xa0be 0x2d69 0x18b1 0xa05a 0x2d1e 0x19de 0xa000 0x2d05 0x1b0b 0x9f9c 0x2cd3 0x1c38 0x9f2e 0x2c88 0x1d65 0x9eb6 0x2c0b 0x1e92 0x9e20 0x2b11 0x1fbf 0x9d8a 0x2a17 0x20ec 0x9cf4 0x2904 0x2219 0x9c5e 0x28a0 0x2346 0x9bdc 0x28b9 0x2473 0x9b6e 0x2904 0x25a0 0x9b0a 0x2904 0x26cd 0x9ab0 0x2904 0x27fa 0x9a56 0x28d2 0x2927 0x9a06 0x28b9 0x2a54 0x99b6 0x28eb 0x2b81 0x9966 0x2936 0x2cae 0x9920 0x2981 0x2ddb 0x98d0 0x2981 0x2f08 0x9880 0x2936 0x3035 0x983a 0x291d 0x3162 0x97ea 0x2887 0x328f 0x97a4 0x280a 0x33bc 0x975e 0x278d 0x34e9 0x9718 0x275b 0x3616 0x96dc 0x278d 0x3743 0x9696 0x283c 0x3870 0x965a 0x28eb 0x399d 0x9628 0x294f 0x3aca 0x95ec 0x2904 0x3bf7 0x95ba 0x283c 0x3d24 0x9588 0x27d8 0x3e51 0x9556 0x2855 0x3f7e 0x952e 0x294f 0x40ab 0x9506 0x29e5 0x41d8 0x94de 0x2981 0x4305 0x94b6 0x28b9 0x4432 0x9498 0x2904 0x455f 0x947a 0x2a17 0x468c 0x9466 0x2ac6 0x47b9 0x9452 0x2a94 0x48e6 0x943e 0x2a30 0x4a13 0x942a 0x2af8 0x4b40 0x9416 0x2c24 0x4c6d 0x9402 0x2d05 0x4d9a 0x93f8 0x2db4 0x4ec7 0x93e4 0x2dcd 0x4ff4 0x93d0 0x2dcd 0x5121 0x93bc 0x2de6 0x524e 0x93a8 0x2e95 0x537b 0x9394 0x3025 0x54a8 0x9380 0x31e7 0x55d5 0x9362 0x327d 0x5702 0x934e 0x32af 0x582f 0x933a 0x32fa 0x595c 0x931c 0x33c2 0x5a89 0x92fe 0x3507 0x5bb6 0x92d6 0x3665 0x5ce3 0x92b8 0x3827 0x5e10 0x9290 0x3921 0x5f3e 0x9268 0x396c 0x606b 0x9240 0x3a02 0x6198 0x920e 0x3bab 0x62c5 0x91dc 0x3dea 0x63f2 0x91aa 0x3fac 0x651f 0x916e 0x405b 0x664c 0x9128 0x40d8 0x677a 0x90e2 0x4281 0x68a7 0x90b0 0x450b 0x69d4 0x907e 0x477c 0x6b01 0x9056 0x48a8 0x6c2e 0x902e 0x4a06 0x6d5b 0x8ffc 0x4dbc 0x6e88 0x8fca 0x5208 0x6fb5 0x8f7a 0x55a5 0x70e2 0x8ed0 0x58f7 0x72ed 0x8c64 0x6176 0x740f 0x8a3e 0x5d2a 0x7525 0x84d0 0x57cb>;
		battery0_profile_t4_num = <0x64>;
		battery1_profile_t0 = <0x00 0xab7c 0x5dc 0x136 0xaadb 0x5dc 0x26c 0xaa46 0x5dc 0x3a1 0xa9c4 0x5dc 0x4d7 0xa946 0x5d0 0x60d 0xa8cb 0x5c3 0x743 0xa856 0x5c3 0x879 0xa7e0 0x5c3 0x9ae 0xa76a 0x5c3 0xae4 0xa6ef 0x5b5 0xc1a 0xa675 0x5af 0xd50 0xa5ff 0x5be 0xe86 0xa589 0x5c3 0xfbb 0xa514 0x5c3 0x10f1 0xa49e 0x5c3 0x1227 0xa429 0x5c3 0x135d 0xa3b6 0x5c3 0x1493 0xa341 0x5d0 0x15c8 0xa2cc 0x5df 0x16fe 0xa25d 0x5ef 0x1834 0xa1ed 0x5fe 0x196a 0xa17e 0x60e 0x1aa0 0xa10e 0x5ff 0x1bd5 0xa09e 0x5f5 0x1d0b 0xa02f 0x5f5 0x1e41 0x9fc4 0x601 0x1f77 0x9f5b 0x60c 0x20ad 0x9ef1 0x5fc 0x21e2 0x9e8b 0x605 0x2318 0x9e28 0x624 0x244e 0x9dc5 0x627 0x2584 0x9d63 0x627 0x26ba 0x9d01 0x627 0x27ef 0x9ca3 0x631 0x2925 0x9c46 0x641 0x2a5b 0x9be9 0x650 0x2b91 0x9b8f 0x660 0x2cc7 0x9b38 0x66f 0x2dfc 0x9ae1 0x672 0x2f32 0x9a89 0x672 0x3068 0x9a2c 0x672 0x319e 0x99c8 0x672 0x32d4 0x995f 0x672 0x3409 0x98e3 0x636 0x353f 0x986e 0x603 0x3675 0x9805 0x5e4 0x37ab 0x97ae 0x5d0 0x38e1 0x975f 0x5c1 0x3a16 0x971c 0x5b2 0x3b4c 0x96dc 0x5b2 0x3c82 0x969e 0x5c1 0x3db8 0x9660 0x5c3 0x3eed 0x9625 0x5c3 0x4023 0x95f4 0x5c3 0x4159 0x95c2 0x5cd 0x428f 0x9591 0x5db 0x43c5 0x955f 0x5bc 0x44fa 0x9530 0x5b0 0x4630 0x9505 0x5c0 0x4766 0x94d9 0x5cf 0x489c 0x94af 0x5df 0x49d2 0x948a 0x5ee 0x4b07 0x9468 0x5fe 0x4c3d 0x9449 0x60d 0x4d73 0x9425 0x60e 0x4ea9 0x9400 0x609 0x4fdf 0x93db 0x5fa 0x5114 0x93ba 0x5f5 0x524a 0x939a 0x5f5 0x5380 0x936f 0x5f5 0x54b6 0x933b 0x5ee 0x55ec 0x92fd 0x5de 0x5721 0x92ba 0x5b4 0x5857 0x927a 0x599 0x598d 0x9248 0x5b8 0x5ac3 0x9217 0x5b0 0x5bf9 0x91e5 0x591 0x5d2e 0x91ba 0x5b0 0x5e64 0x9194 0x5c3 0x5f9a 0x9175 0x5c3 0x60d0 0x9148 0x5b7 0x6206 0x9117 0x5ac 0x633b 0x90e5 0x5bc 0x6471 0x90ad 0x5c3 0x65a7 0x906f 0x5c3 0x66dd 0x9031 0x5c3 0x6813 0x8ff2 0x5c3 0x6948 0x8fad 0x5c3 0x6a7e 0x8f90 0x5ce 0x6bb4 0x8f83 0x5dd 0x6cea 0x8f70 0x5ed 0x6e20 0x8f55 0x60a 0x6f55 0x8f30 0x639 0x708b 0x8e8d 0x626 0x71c1 0x8d92 0x60e 0x72f7 0x8bbb 0x60e 0x742d 0x893e 0x62a 0x7562 0x8659 0x658 0x7698 0x8564 0x9ef 0x77ce 0x84d0 0xccb>;
		battery1_profile_t0_num = <0x64>;
		battery1_profile_t1 = <0x00 0xaba4 0x834 0x136 0xaac5 0x834 0x26c 0xaa00 0x834 0x3a1 0xa965 0x834 0x4d7 0xa8d4 0x834 0x60d 0xa847 0x832 0x743 0xa7c5 0x822 0x879 0xa747 0x81b 0x9ae 0xa6cb 0x81b 0xae4 0xa64f 0x81b 0xc1a 0xa5d5 0x81b 0xd50 0xa55f 0x81b 0xe86 0xa4e9 0x81b 0xfbb 0xa474 0x81b 0x10f1 0xa3fe 0x81b 0x1227 0xa389 0x81b 0x135d 0xa316 0x81b 0x1493 0xa2a6 0x81b 0x15c8 0xa236 0x81e 0x16fe 0xa1c7 0x82e 0x1834 0xa157 0x834 0x196a 0xa0e8 0x834 0x1aa0 0xa078 0x825 0x1bd5 0xa00b 0x821 0x1d0b 0x9fa1 0x830 0x1e41 0x9f38 0x834 0x1f77 0x9ed0 0x838 0x20ad 0x9e6d 0x857 0x21e2 0x9e06 0x866 0x2318 0x9d9d 0x866 0x244e 0x9d2e 0x866 0x2584 0x9cc1 0x866 0x26ba 0x9c59 0x866 0x27ef 0x9bfd 0x870 0x2925 0x9ba6 0x880 0x2a5b 0x9b50 0x88f 0x2b91 0x9af6 0x898 0x2cc7 0x9a99 0x898 0x2dfc 0x9a37 0x88b 0x2f32 0x99d3 0x879 0x3068 0x996a 0x85a 0x319e 0x9900 0x832 0x32d4 0x9897 0x803 0x3409 0x983a 0x7e4 0x353f 0x97df 0x7c5 0x3675 0x9788 0x7a6 0x37ab 0x973b 0x79e 0x38e1 0x96f1 0x79c 0x3a16 0x96ae 0x78d 0x3b4c 0x9671 0x785 0x3c82 0x9639 0x785 0x3db8 0x9601 0x785 0x3eed 0x95cb 0x789 0x4023 0x959a 0x798 0x4159 0x9568 0x79e 0x428f 0x9537 0x79e 0x43c5 0x950b 0x79e 0x44fa 0x94e0 0x79e 0x4630 0x94b5 0x79e 0x4766 0x948e 0x79e 0x489c 0x9469 0x7a1 0x49d2 0x9444 0x7b0 0x4b07 0x9422 0x7c0 0x4c3d 0x9403 0x7cf 0x4d73 0x93df 0x7c1 0x4ea9 0x93be 0x7bc 0x4fdf 0x93a5 0x7cb 0x5114 0x9388 0x7c5 0x524a 0x936a 0x7b8 0x5380 0x9351 0x7c8 0x54b6 0x9338 0x7d0 0x55ec 0x9320 0x7d0 0x5721 0x9307 0x7dd 0x5857 0x92eb 0x7e9 0x598d 0x92c6 0x7e9 0x5ac3 0x92a1 0x7e9 0x5bf9 0x927b 0x7e9 0x5d2e 0x9250 0x7f9 0x5e64 0x9227 0x80e 0x5f9a 0x9202 0x82d 0x60d0 0x91d4 0x84c 0x6206 0x91a1 0x86a 0x633b 0x9163 0x889 0x6471 0x9122 0x8a8 0x65a7 0x90de 0x8c7 0x66dd 0x9094 0x8f4 0x6813 0x904a 0x91a 0x6948 0x8fff 0x929 0x6a7e 0x8fd3 0x90a 0x6bb4 0x8fb3 0x969 0x6cea 0x8f8e 0x981 0x6e20 0x8f5b 0x9a7 0x6f55 0x8f17 0x9de 0x708b 0x8e50 0x9fa 0x71c1 0x8d2a 0xa2b 0x72f7 0x8b15 0xab0 0x742d 0x8826 0xaff 0x7562 0x84af 0xb45 0x7698 0x7ae4 0xb35 0x77ce 0x74e0 0xc03>;
		battery1_profile_t1_num = <0x64>;
		battery1_profile_t2 = <0x00 0xab9a 0xb86 0x136 0xaaa8 0xabd 0x26c 0xa9d3 0xa35 0x3a1 0xa92c 0xa16 0x4d7 0xa898 0x9f7 0x60d 0xa80b 0x9d8 0x743 0xa789 0x9b9 0x879 0xa70b 0x9a3 0x9ae 0xa68f 0x993 0xae4 0xa618 0x984 0xc1a 0xa5a3 0x974 0xd50 0xa52d 0x965 0xe86 0xa4b7 0x955 0xfbb 0xa442 0x946 0x10f1 0xa3cc 0x936 0x1227 0xa35a 0x92e 0x135d 0xa2ed 0x92e 0x1493 0xa279 0x921 0x15c8 0xa205 0x915 0x16fe 0xa19c 0x915 0x1834 0xa12f 0x915 0x196a 0xa0c0 0x915 0x1aa0 0xa050 0x906 0x1bd5 0x9fe3 0x8fc 0x1d0b 0x9f79 0x8fc 0x1e41 0x9f15 0x908 0x1f77 0x9eb2 0x917 0x20ad 0x9e4f 0x927 0x21e2 0x9de5 0x926 0x2318 0x9d75 0x916 0x244e 0x9d06 0x915 0x2584 0x9c9b 0x915 0x26ba 0x9c39 0x915 0x27ef 0x9bdb 0x91f 0x2925 0x9b7e 0x92e 0x2a5b 0x9b28 0x92e 0x2b91 0x9ace 0x92e 0x2cc7 0x9a71 0x92e 0x2dfc 0x9a0f 0x915 0x2f32 0x99ac 0x8f9 0x3068 0x9949 0x8e9 0x319e 0x98e2 0x8c8 0x32d4 0x9879 0x899 0x3409 0x981c 0x87a 0x353f 0x97c3 0x860 0x3675 0x9773 0x851 0x37ab 0x9727 0x841 0x38e1 0x96dd 0x832 0x3a16 0x969a 0x823 0x3b4c 0x965d 0x81b 0x3c82 0x9625 0x81b 0x3db8 0x95ed 0x81b 0x3eed 0x95b7 0x81b 0x4023 0x9586 0x81b 0x4159 0x9554 0x81b 0x428f 0x9523 0x81b 0x43c5 0x94f7 0x81b 0x44fa 0x94cf 0x821 0x4630 0x94a9 0x831 0x4766 0x9484 0x840 0x489c 0x945f 0x84d 0x49d2 0x943a 0x84d 0x4b07 0x9418 0x856 0x4c3d 0x93f9 0x865 0x4d73 0x93db 0x866 0x4ea9 0x93bc 0x861 0x4fdf 0x939d 0x852 0x5114 0x9387 0x858 0x524a 0x9374 0x867 0x5380 0x935b 0x877 0x54b6 0x9342 0x87f 0x55ec 0x932a 0x87f 0x5721 0x930b 0x87f 0x5857 0x92ec 0x883 0x598d 0x92cd 0x892 0x5ac3 0x92a7 0x898 0x5bf9 0x927b 0x898 0x5d2e 0x9256 0x8b7 0x5e64 0x922c 0x8d0 0x5f9a 0x91fb 0x8e0 0x60d0 0x91ca 0x907 0x6206 0x9196 0x932 0x633b 0x9152 0x951 0x6471 0x9111 0x981 0x65a7 0x90d3 0x9bf 0x66dd 0x9084 0x9ee 0x6813 0x9038 0xa22 0x6948 0x8ff3 0xa5f 0x6a7e 0x8fc5 0xabd 0x6bb4 0x8f9f 0xb2d 0x6cea 0x8f74 0xbc8 0x6e20 0x8f37 0xc86 0x6f55 0x8ee7 0xd6f 0x708b 0x8df4 0xe16 0x71c1 0x8c9e 0xed4 0x72f7 0x8a5e 0x100a 0x742d 0x871f 0x1209 0x7562 0x8341 0x1487 0x7698 0x78ef 0x1e77 0x77ce 0x74f4 0x1883>;
		battery1_profile_t2_num = <0x64>;
		battery1_profile_t3 = <0x00 0xabe0 0xc9e 0x136 0xab01 0x1877 0x26c 0xaa33 0x1fab 0x3a1 0xa97f 0x1f7d 0x4d7 0xa8d5 0x1f36 0x60d 0xa830 0x1eeb 0x743 0xa795 0x1ead 0x879 0xa700 0x1e5e 0x9ae 0xa672 0x1e01 0xae4 0xa5e3 0x1d96 0xc1a 0xa559 0x1d38 0xd50 0xa4d7 0x1cfa 0xe86 0xa455 0x1cb2 0xfbb 0xa3d3 0x1c67 0x10f1 0xa357 0x1c38 0x1227 0xa2df 0x1c0a 0x135d 0xa26c 0x1bdd 0x1493 0xa1f7 0x1ba2 0x15c8 0xa182 0x1b67 0x16fe 0xa113 0x1b39 0x1834 0xa0a7 0x1b1d 0x196a 0xa03d 0x1b0d 0x1aa0 0x9fd4 0x1aee 0x1bd5 0x9f68 0x1acf 0x1d0b 0x9ef9 0x1ab0 0x1e41 0x9e80 0x1a7a 0x1f77 0x9e03 0x1a3a 0x20ad 0x9d81 0x19ec 0x21e2 0x9d06 0x19a7 0x2318 0x9c90 0x1969 0x244e 0x9c25 0x1939 0x2584 0x9bbf 0x1910 0x26ba 0x9b5d 0x18f1 0x27ef 0x9aff 0x18dd 0x2925 0x9aa2 0x18cd 0x2a5b 0x9a45 0x18ae 0x2b91 0x99e6 0x1881 0x2cc7 0x9982 0x1843 0x2dfc 0x9924 0x1812 0x2f32 0x98c9 0x17e7 0x3068 0x9872 0x17c8 0x319e 0x981f 0x17b2 0x32d4 0x97ce 0x17a2 0x3409 0x977e 0x1793 0x353f 0x9732 0x1789 0x3675 0x96ed 0x1789 0x37ab 0x96ae 0x1789 0x38e1 0x9670 0x1789 0x3a16 0x9633 0x1789 0x3b4c 0x95f9 0x1791 0x3c82 0x95c1 0x17a0 0x3db8 0x958f 0x17a2 0x3eed 0x955f 0x17a6 0x4023 0x9533 0x17b5 0x4159 0x9508 0x17c5 0x428f 0x94dd 0x17d5 0x43c5 0x94be 0x1804 0x44fa 0x949f 0x1832 0x4630 0x9480 0x1861 0x4766 0x9466 0x188f 0x489c 0x944f 0x18c3 0x49d2 0x943c 0x1911 0x4b07 0x9426 0x194d 0x4c3d 0x940d 0x197b 0x4d73 0x93fb 0x19d4 0x4ea9 0x93e8 0x1a30 0x4fdf 0x93d6 0x1a8d 0x5114 0x93c3 0x1b00 0x524a 0x93b0 0x1b7d 0x5380 0x9397 0x1c08 0x54b6 0x937e 0x1c94 0x55ec 0x9366 0x1d1f 0x5721 0x9347 0x1db8 0x5857 0x9328 0x1e5a 0x598d 0x9309 0x1f14 0x5ac3 0x92e7 0x1fce 0x5bf9 0x92c1 0x2088 0x5d2e 0x929c 0x2161 0x5e64 0x9272 0x223a 0x5f9a 0x9241 0x2313 0x60d0 0x9210 0x240c 0x6206 0x91de 0x2511 0x633b 0x91a6 0x2628 0x6471 0x916b 0x2747 0x65a7 0x912d 0x286d 0x66dd 0x90ea 0x29be 0x6813 0x90a6 0x2b2a 0x6948 0x9061 0x2ccc 0x6a7e 0x9022 0x2e79 0x6bb4 0x8fe4 0x302e 0x6cea 0x8fac 0x320e 0x6e20 0x8f72 0x33e7 0x6f55 0x8f34 0x35b8 0x708b 0x8ecc 0x3789 0x71c1 0x8e35 0x3948 0x72f7 0x8d18 0x3acb 0x742d 0x8b56 0x3d0e 0x7562 0x892d 0x3fc8 0x7698 0x85c9 0x41eb 0x77ce 0x8444 0x3e35>;
		battery1_profile_t3_num = <0x64>;
		battery1_profile_t4 = <0x00 0xabe0 0x1f90 0x136 0xaabd 0x2f96 0x26c 0xa9c0 0x394e 0x3a1 0xa900 0x3901 0x4d7 0xa81e 0x36c9 0x60d 0xa738 0x3471 0x743 0xa66b 0x3471 0x879 0xa5ac 0x33fb 0x9ae 0xa4f9 0x3322 0xae4 0xa45c 0x3258 0xc1a 0xa3c5 0x3193 0xd50 0xa336 0x30d9 0xe86 0xa29f 0x3015 0xfbb 0xa207 0x2f51 0x10f1 0xa18b 0x2ec5 0x1227 0xa110 0x2e42 0x135d 0xa097 0x2dc9 0x1493 0xa01b 0x2d41 0x15c8 0x9f9b 0x2cb2 0x16fe 0x9f0d 0x2c17 0x1834 0x9e7e 0x2b73 0x196a 0x9df0 0x2ac8 0x1aa0 0x9d6e 0x2a4c 0x1bd5 0x9cf2 0x29db 0x1d0b 0x9c83 0x297e 0x1e41 0x9c1d 0x292d 0x1f77 0x9bbb 0x28e7 0x20ad 0x9b5e 0x28c8 0x21e2 0x9b01 0x2898 0x2318 0x9aa4 0x285a 0x244e 0x9a47 0x282a 0x2584 0x99ec 0x27fc 0x26ba 0x9997 0x27cf 0x27ef 0x9941 0x27b5 0x2925 0x98ea 0x27a4 0x2a5b 0x9894 0x2776 0x2b91 0x9842 0x274e 0x2cc7 0x97f8 0x272f 0x2dfc 0x97ad 0x2710 0x2f32 0x9764 0x26fa 0x3068 0x9720 0x270a 0x319e 0x96dc 0x26fe 0x32d4 0x9698 0x26df 0x3409 0x9660 0x26ed 0x353f 0x962a 0x2702 0x3675 0x95f9 0x2721 0x37ab 0x95c7 0x2735 0x38e1 0x9597 0x2746 0x3a16 0x9573 0x2764 0x3b4c 0x9551 0x2792 0x3c82 0x9532 0x27d0 0x3db8 0x9513 0x2800 0x3eed 0x94f4 0x282f 0x4023 0x94d5 0x285d 0x4159 0x94ba 0x28aa 0x428f 0x94a1 0x2907 0x43c5 0x9489 0x2964 0x44fa 0x9470 0x29c7 0x4630 0x9457 0x2a33 0x4766 0x943e 0x2a93 0x489c 0x9425 0x2af9 0x49d2 0x940d 0x2b84 0x4b07 0x93f4 0x2c19 0x4c3d 0x93db 0x2cb4 0x4d73 0x93bd 0x2d3d 0x4ea9 0x93a0 0x2dd5 0x4fdf 0x9387 0x2e8f 0x5114 0x936a 0x2f54 0x524a 0x934b 0x301c 0x5380 0x932c 0x30d6 0x54b6 0x930d 0x3190 0x55ec 0x92ee 0x3249 0x5721 0x92ca 0x3303 0x5857 0x92a5 0x33c5 0x598d 0x9280 0x349e 0x5ac3 0x925b 0x358a 0x5bf9 0x9235 0x3681 0x5d2e 0x920a 0x373b 0x5e64 0x91dc 0x37fb 0x5f9a 0x91ab 0x38c4 0x60d0 0x917a 0x39a2 0x6206 0x9148 0x3a87 0x633b 0x9110 0x3b6f 0x6471 0x90d5 0x3c57 0x65a7 0x9097 0x3d40 0x66dd 0x905f 0x3e53 0x6813 0x9029 0x3f77 0x6948 0x8ff8 0x40bd 0x6a7e 0x8fc2 0x4241 0x6bb4 0x8f88 0x43e9 0x6cea 0x8f38 0x45d9 0x6e20 0x8ec8 0x480f 0x6f55 0x8e33 0x4a9a 0x708b 0x8d0c 0x4ddb 0x71c1 0x8bb1 0x4fea 0x72f7 0x8781 0x4667 0x742d 0x8480 0x3efd 0x7562 0x8480 0x3efd 0x7698 0x8480 0x3efd 0x77ce 0x8480 0x3efd>;
		battery1_profile_t4_num = <0x64>;
		compatible = "mediatek,bat_gm30";
		g_FG_PSEUDO100_T0 = <0x62>;
		g_FG_PSEUDO100_T1 = <0x62>;
		g_FG_PSEUDO100_T2 = <0x5f>;
		g_FG_PSEUDO100_T3 = <0x5a>;
		g_FG_PSEUDO100_T4 = <0x50>;
		linux,phandle = <0x58>;
		phandle = <0x58>;
	};

	bpi_bsi_slv0@1021e000 {
		compatible = "mediatek,bpi_bsi_slv0";
		reg = <0x00 0x1021e000 0x00 0x1000>;
	};

	bpi_bsi_slv1@1021f000 {
		compatible = "mediatek,bpi_bsi_slv1";
		reg = <0x00 0x1021f000 0x00 0x6000>;
	};

	bpi_bsi_slv2@10225000 {
		compatible = "mediatek,bpi_bsi_slv2";
		reg = <0x00 0x10225000 0x00 0x1000>;
	};

	btcvsd@10001000 {
		compatible = "mediatek,audio_bt_cvsd";
		interrupts = <0x00 0xe8 0x08>;
		offset = <0xf00 0x800 0xfd0 0xfd4 0xfd8>;
		reg = <0x00 0x10001000 0x00 0x1000 0x00 0x18000000 0x00 0x10000 0x00 0x18080000 0x00 0x8000>;
	};

	btif@1100c000 {
		#address-cells = <0x02>;
		#size-cells = <0x02>;
		clock-names = "btifc\0apdmac";
		clocks = <0x19 0x1a 0x19 0x28>;
		compatible = "mediatek,btif";
		interrupts = <0x00 0x70 0x08 0x00 0x6c 0x08 0x00 0x6d 0x08>;
		reg = <0x00 0x1100c000 0x00 0x1000 0x00 0x11000600 0x00 0x80 0x00 0x11000680 0x00 0x80>;
	};

	bus_dbg@10208000 {
		compatible = "mediatek,bus_dbg-v2";
		interrupts = <0x00 0x8d 0x08>;
		mediatek,bus_dbg_con_offset = <0x2fc>;
		reg = <0x00 0x10208000 0x00 0x1000 0x00 0x10001000 0x00 0x1000>;
	};

	cam_a@15004000 {
		compatible = "mediatek,cam_a";
		reg = <0x00 0x15004000 0x00 0x1000>;
	};

	cam_a_inner@1500d000 {
		compatible = "mediatek,cam_a_inner";
		reg = <0x00 0x1500d000 0x00 0x1000>;
	};

	cam_b@15005000 {
		compatible = "mediatek,cam_b";
		interrupts = <0x00 0xd9 0x08>;
		reg = <0x00 0x15005000 0x00 0x1000>;
	};

	cam_c@15006000 {
		compatible = "mediatek,cam_c";
		interrupts = <0x00 0xda 0x08>;
		reg = <0x00 0x15006000 0x00 0x1000>;
	};

	cam_c_inner@1500e000 {
		compatible = "mediatek,cam_c_inner";
		reg = <0x00 0x1500e000 0x00 0x1000>;
	};

	cam_cal_drv_s5k3l8_eeprom {
		compatible = "mediatek,cam_cal_drv_s5k3l8_eeprom";
		linux,phandle = <0x52>;
		phandle = <0x52>;
	};

	cam_d@15007000 {
		compatible = "mediatek,cam_d";
		interrupts = <0x00 0xdb 0x08>;
		reg = <0x00 0x15007000 0x00 0x1000>;
	};

	cam_d_inner@1500f000 {
		compatible = "mediatek,cam_d_inner";
		reg = <0x00 0x1500f000 0x00 0x1000>;
	};

	camsv@15009000 {
		compatible = "mediatek,camsv";
		interrupts = <0x00 0xdc 0x08>;
		reg = <0x00 0x15009000 0x00 0x1000>;
	};

	charger {
		ac_charger_current = <0x124f80>;
		ac_charger_input_current = <0x124f80>;
		algorithm_name = "LinearCharging";
		apple_1_0a_charger_current = <0x9eb10>;
		apple_2_1a_charger_current = "\0\f5";
		battery_cv = <0x432380>;
		bif_cv_under_threshold2 = <0x43e6d0>;
		bif_threshold1 = <0x40d990>;
		bif_threshold2 = <0x419ce0>;
		cable_imp_threshold = <0x2bb>;
		charging_host_charger_current = <0x7a120>;
		chg1_ta_ac_charger_current = <0x16e360>;
		chg2_ta_ac_charger_current = <0x16e360>;
		chg_full_current = <0x249f0>;
		compatible = "mediatek,charger";
		enable_min_charge_temperature;
		enable_sw_jeita;
		jeita_temp_above_t4_cv_voltage = <0x3e8fa0>;
		jeita_temp_below_t0_cv_voltage = <0x432380>;
		jeita_temp_t0_to_t1_cv_voltage = <0x432380>;
		jeita_temp_t1_to_t2_cv_voltage = <0x432380>;
		jeita_temp_t2_to_t3_cv_voltage = <0x432380>;
		jeita_temp_t3_to_t4_cv_voltage = <0x3e8fa0>;
		linux,phandle = <0x5a>;
		max_charge_temperature = <0x35>;
		max_charge_temperature_minus_x_degree = <0x34>;
		max_charger_voltage = <0x5a06e0>;
		max_charging_time = <0xa8c0>;
		min_charge_temperature = <0x00>;
		min_charge_temperature_plus_x_degree = <0x01>;
		non_std_ac_charger_current = <0x7a120>;
		pe20_ichg_level_threshold = <0x3e8>;
		phandle = <0x5a>;
		recharge_offset = <0x186a0>;
		ta_ac_charger_current = <0x2dc6c0>;
		ta_start_battery_soc = <0x00>;
		ta_stop_battery_soc = <0x55>;
		temp_neg_10_threshold = <0x02>;
		temp_t0_thres_plus_x_degree = <0x01>;
		temp_t0_threshold = <0x01>;
		temp_t1_thres_plus_x_degree = <0x01>;
		temp_t1_threshold = <0x01>;
		temp_t2_thres_plus_x_degree = <0x10>;
		temp_t2_threshold = <0x0f>;
		temp_t3_thres_minus_x_degree = <0x2c>;
		temp_t3_threshold = <0x2d>;
		temp_t4_thres_minus_x_degree = <0x33>;
		temp_t4_threshold = <0x37>;
		topoff_voltage = <0x401640>;
		usb_charger_current = <0x7a120>;
		usb_charger_current_configured = <0x7a120>;
		usb_charger_current_suspend = <0x00>;
		usb_charger_current_unconfigured = <0x11170>;
		vbat_cable_imp_threshold = <0xf3c>;
	};

	charger_guuge {
		compatible = "mediatek,mt6357_charger";
	};

	chipid@08000000 {
		compatible = "mediatek,chipid";
		reg = <0x00 0x8000000 0x00 0x04 0x00 0x8000004 0x00 0x04 0x00 0x8000008 0x00 0x04 0x00 0x800000c 0x00 0x04>;
	};

	chosen {
		bootargs = "console=tty0 console=ttyMT3,921600n1 vmalloc=496M slub_max_order=0 slub_debug=OFZPU androidboot.hardware=mt6739 maxcpus=8 firmware_class.path=/vendor/firmware loop.max_part=7";
		linux,phandle = <0x38>;
		phandle = <0x38>;
	};

	chr_stat {
		linux,phandle = <0x64>;
		phandle = <0x64>;
	};

	clk26m {
		#clock-cells = <0x00>;
		clock-frequency = <0x18cba80>;
		compatible = "fixed-clock";
		linux,phandle = <0x25>;
		phandle = <0x25>;
	};

	clk32k {
		#clock-cells = <0x00>;
		clock-frequency = <0x7d00>;
		compatible = "fixed-clock";
		linux,phandle = <0x18>;
		phandle = <0x18>;
	};

	consys@18070000 {
		#address-cells = <0x02>;
		#size-cells = <0x02>;
		clock-names = "conn";
		clocks = <0x1a 0x03>;
		compatible = "mediatek,mt6739-consys";
		interrupts = <0x00 0xe9 0x08 0x00 0xeb 0x02>;
		linux,phandle = <0x5c>;
		phandle = <0x5c>;
		reg = <0x00 0x18070000 0x00 0x200 0x00 0x10007000 0x00 0x100 0x00 0x10000000 0x00 0x2000 0x00 0x10006000 0x00 0x1000>;
	};

	cpu_dbgapb {
		compatible = "mediatek,hw_dbg";
		linux,phandle = <0x39>;
		num = <0x04>;
		phandle = <0x39>;
		reg = <0x00 0xd410000 0x00 0x1000 0x00 0xd510000 0x00 0x1000 0x00 0xd610000 0x00 0x1000 0x00 0xd710000 0x00 0x1000>;
	};

	cpus {
		#address-cells = <0x01>;
		#size-cells = <0x00>;

		cpu-map {

			cluster0 {

				core0 {
					cpu = <0x0a>;
				};

				core1 {
					cpu = <0x0b>;
				};

				core2 {
					cpu = <0x0c>;
				};

				core3 {
					cpu = <0x0d>;
				};
			};
		};

		cpu@0 {
			clock-frequency = <0x77359400>;
			compatible = "arm,cortex-a53";
			cpu-idle-states = <0x03 0x04 0x05 0x06 0x07 0x08 0x09>;
			cpu-release-addr = <0x00 0x40000200>;
			device_type = "cpu";
			enable-method = "psci";
			linux,phandle = <0x0a>;
			phandle = <0x0a>;
			reg = <0x00>;
		};

		cpu@001 {
			clock-frequency = <0x61a1e580>;
			compatible = "arm,cortex-a53";
			cpu-idle-states = <0x03 0x04 0x05 0x06 0x07 0x08 0x09>;
			cpu-release-addr = <0x00 0x40000200>;
			device_type = "cpu";
			enable-method = "psci";
			linux,phandle = <0x0b>;
			phandle = <0x0b>;
			reg = <0x01>;
		};

		cpu@002 {
			clock-frequency = <0x61a1e580>;
			compatible = "arm,cortex-a53";
			cpu-idle-states = <0x03 0x04 0x05 0x06 0x07 0x08 0x09>;
			cpu-release-addr = <0x00 0x40000200>;
			device_type = "cpu";
			enable-method = "psci";
			linux,phandle = <0x0c>;
			phandle = <0x0c>;
			reg = <0x02>;
		};

		cpu@003 {
			clock-frequency = <0x61a1e580>;
			compatible = "arm,cortex-a53";
			cpu-idle-states = <0x03 0x04 0x05 0x06 0x07 0x08 0x09>;
			cpu-release-addr = <0x00 0x40000200>;
			device_type = "cpu";
			enable-method = "psci";
			linux,phandle = <0x0d>;
			phandle = <0x0d>;
			reg = <0x03>;
		};

		idle-states {
			entry-method = "arm,psci";

			dpidle {
				arm,psci-suspend-param = <0x1010004>;
				compatible = "arm,idle-state";
				entry-latency-us = <0x320>;
				exit-latency-us = <0x3e8>;
				linux,phandle = <0x08>;
				min-residency-us = <0x7d0>;
				phandle = <0x08>;
			};

			mcdi-cluster {
				arm,psci-suspend-param = <0x1010001>;
				compatible = "arm,idle-state";
				entry-latency-us = <0x258>;
				exit-latency-us = <0x258>;
				linux,phandle = <0x05>;
				min-residency-us = <0x4b0>;
				phandle = <0x05>;
			};

			mcdi-cpu {
				arm,psci-suspend-param = <0x10001>;
				compatible = "arm,idle-state";
				entry-latency-us = <0x258>;
				exit-latency-us = <0x258>;
				linux,phandle = <0x04>;
				min-residency-us = <0x4b0>;
				phandle = <0x04>;
			};

			sodi {
				arm,psci-suspend-param = <0x1010002>;
				compatible = "arm,idle-state";
				entry-latency-us = <0x320>;
				exit-latency-us = <0x3e8>;
				linux,phandle = <0x06>;
				min-residency-us = <0x7d0>;
				phandle = <0x06>;
			};

			sodi3 {
				arm,psci-suspend-param = <0x1010003>;
				compatible = "arm,idle-state";
				entry-latency-us = <0x320>;
				exit-latency-us = <0x3e8>;
				linux,phandle = <0x07>;
				min-residency-us = <0x7d0>;
				phandle = <0x07>;
			};

			standby {
				arm,psci-suspend-param = <0x01>;
				compatible = "arm,idle-state";
				entry-latency-us = <0x258>;
				exit-latency-us = <0x258>;
				linux,phandle = <0x03>;
				min-residency-us = <0x4b0>;
				phandle = <0x03>;
			};

			suspend {
				arm,psci-suspend-param = <0x1010005>;
				compatible = "arm,idle-state";
				entry-latency-us = <0x320>;
				exit-latency-us = <0x3e8>;
				linux,phandle = <0x09>;
				min-residency-us = <0x7d0>;
				phandle = <0x09>;
			};
		};
	};

	cq_dma@10212000 {
		clock-names = "cqdma";
		clocks = <0x19 0x44>;
		compatible = "mediatek,mt-cqdma-v1";
		interrupts = <0x00 0x72 0x08>;
		keep_clock_ao = "yes";
		nr_channel = <0x01>;
		reg = <0x00 0x10212080 0x00 0x80>;
	};

	dbg_apmcu_mp0@0d400000 {
		compatible = "mediatek,dbg_apmcu_mp0";
		reg = <0x00 0xd400000 0x00 0x1000>;
	};

	dbg_apmcu_mp0@0d410000 {
		compatible = "mediatek,dbg_apmcu_mp0";
		reg = <0x00 0xd410000 0x00 0x1000>;
	};

	dbg_apmcu_mp0@0d420000 {
		compatible = "mediatek,dbg_apmcu_mp0";
		reg = <0x00 0xd420000 0x00 0x1000>;
	};

	dbg_apmcu_mp0@0d430000 {
		compatible = "mediatek,dbg_apmcu_mp0";
		reg = <0x00 0xd430000 0x00 0x1000>;
	};

	dbg_apmcu_mp0@0d440000 {
		compatible = "mediatek,dbg_apmcu_mp0";
		reg = <0x00 0xd440000 0x00 0x1000>;
	};

	dbg_apmcu_mp0@0d510000 {
		compatible = "mediatek,dbg_apmcu_mp0";
		reg = <0x00 0xd510000 0x00 0x1000>;
	};

	dbg_apmcu_mp0@0d520000 {
		compatible = "mediatek,dbg_apmcu_mp0";
		reg = <0x00 0xd520000 0x00 0x1000>;
	};

	dbg_apmcu_mp0@0d530000 {
		compatible = "mediatek,dbg_apmcu_mp0";
		reg = <0x00 0xd530000 0x00 0x1000>;
	};

	dbg_apmcu_mp0@0d540000 {
		compatible = "mediatek,dbg_apmcu_mp0";
		reg = <0x00 0xd540000 0x00 0x1000>;
	};

	dbg_apmcu_mp0@0d610000 {
		compatible = "mediatek,dbg_apmcu_mp0";
		reg = <0x00 0xd610000 0x00 0x1000>;
	};

	dbg_apmcu_mp0@0d620000 {
		compatible = "mediatek,dbg_apmcu_mp0";
		reg = <0x00 0xd620000 0x00 0x1000>;
	};

	dbg_apmcu_mp0@0d630000 {
		compatible = "mediatek,dbg_apmcu_mp0";
		reg = <0x00 0xd630000 0x00 0x1000>;
	};

	dbg_apmcu_mp0@0d640000 {
		compatible = "mediatek,dbg_apmcu_mp0";
		reg = <0x00 0xd640000 0x00 0x1000>;
	};

	dbg_apmcu_mp0@0d710000 {
		compatible = "mediatek,dbg_apmcu_mp0";
		reg = <0x00 0xd710000 0x00 0x1000>;
	};

	dbg_apmcu_mp0@0d720000 {
		compatible = "mediatek,dbg_apmcu_mp0";
		reg = <0x00 0xd720000 0x00 0x1000>;
	};

	dbg_apmcu_mp0@0d730000 {
		compatible = "mediatek,dbg_apmcu_mp0";
		reg = <0x00 0xd730000 0x00 0x1000>;
	};

	dbg_apmcu_mp0@0d740000 {
		compatible = "mediatek,dbg_apmcu_mp0";
		reg = <0x00 0xd740000 0x00 0x1000>;
	};

	dbg_apmcu_mp1@0d800000 {
		compatible = "mediatek,dbg_apmcu_mp1";
		reg = <0x00 0xd800000 0x00 0x00>;
	};

	dbg_cti@0d020000 {
		compatible = "mediatek,dbg_cti";
		reg = <0x00 0xd020000 0x00 0x10000>;
	};

	dbg_dem@0d0a0000 {
		compatible = "mediatek,dbg_dem";
		interrupts = <0x00 0x8c 0x08>;
		reg = <0x00 0xd0a0000 0x00 0x10000>;
	};

	dbg_etb@0d010000 {
		compatible = "mediatek,dbg_etb";
		reg = <0x00 0xd010000 0x00 0x10000>;
	};

	dbg_etr@0d030000 {
		compatible = "mediatek,dbg_etr";
		reg = <0x00 0xd030000 0x00 0x10000>;
	};

	dbg_funnel@0d040000 {
		compatible = "mediatek,dbg_funnel";
		reg = <0x00 0xd040000 0x00 0x10000>;
	};

	dbg_mdsys1@0d0c0000 {
		compatible = "mediatek,dbg_mdsys1";
		reg = <0x00 0xd0c0000 0x00 0x40000>;
	};

	dbi0@14013000 {
		compatible = "mediatek,dbi0";
		interrupts = <0x00 0xd2 0x08>;
		reg = <0x00 0x14013000 0x00 0x1000>;
	};

	ddrphy@1001e000 {
		compatible = "mediatek,ddrphy";
		reg = <0x00 0x1001e000 0x00 0x1000>;
	};

	devapc@10207000 {
		clock-names = "devapc-infra-clock";
		clocks = <0x19 0x2a>;
		compatible = "mediatek,devapc";
		interrupts = <0x00 0x8e 0x08>;
		reg = <0x00 0x10207000 0x00 0x1000>;
	};

	dfd@0c600000 {
		compatible = "mediatek,dfd";
		reg = <0x00 0xc600000 0x00 0x00>;
	};

	disp_aal0@1400f000 {
		aal_support = <0x01>;
		compatible = "mediatek,disp_aal0";
		interrupts = <0x00 0xce 0x08>;
		linux,phandle = <0x54>;
		phandle = <0x54>;
		reg = <0x00 0x1400f000 0x00 0x1000>;
	};

	disp_ccorr0@1400e000 {
		compatible = "mediatek,disp_ccorr0";
		interrupts = <0x00 0xcd 0x08>;
		reg = <0x00 0x1400e000 0x00 0x1000>;
	};

	disp_color0@1400d000 {
		compatible = "mediatek,disp_color0";
		interrupts = <0x00 0xcc 0x08>;
		reg = <0x00 0x1400d000 0x00 0x1000>;
	};

	disp_dither0@14011000 {
		compatible = "mediatek,disp_dither0";
		interrupts = <0x00 0xd0 0x08>;
		reg = <0x00 0x14011000 0x00 0x1000>;
	};

	disp_gamma0@14010000 {
		compatible = "mediatek,disp_gamma0";
		interrupts = <0x00 0xcf 0x08>;
		reg = <0x00 0x14010000 0x00 0x1000>;
	};

	disp_mutex@14001000 {
		compatible = "mediatek,disp_mutex";
		interrupts = <0x00 0xc2 0x08>;
		linux,phandle = <0x22>;
		phandle = <0x22>;
		reg = <0x00 0x14001000 0x00 0x1000>;
	};

	disp_ovl0@1400a000 {
		clock-names = "DISP_OVL0";
		clocks = <0x1b 0x0c>;
		compatible = "mediatek,disp_ovl0";
		interrupts = <0x00 0xc9 0x08>;
		linux,phandle = <0x23>;
		phandle = <0x23>;
		reg = <0x00 0x1400a000 0x00 0x1000>;
	};

	disp_pwm0@1100e000 {
		compatible = "mediatek,disp_pwm0";
		reg = <0x00 0x1100e000 0x00 0x1000>;
	};

	disp_rdma0@1400b000 {
		compatible = "mediatek,disp_rdma0";
		interrupts = <0x00 0xca 0x08>;
		reg = <0x00 0x1400b000 0x00 0x1000>;
	};

	disp_wdma0@1400c000 {
		compatible = "mediatek,disp_wdma0";
		interrupts = <0x00 0xcb 0x08>;
		reg = <0x00 0x1400c000 0x00 0x1000>;
	};

	dispsys@14000000 {
		clock-names = "CLK_MM_MTCMOS\0CLK_MM_SMI_COMMON\0CLK_MM_SMI_LARB0\0CLK_MM_GALS_COMM0\0CLK_MM_GALS_COMM1\0CLK_MM_DISP_OVL0\0CLK_MM_DISP_RDMA0\0CLK_MM_DISP_WDMA0\0CLK_MM_DISP_COLOR0\0CLK_MM_DISP_CCORR0\0CLK_MM_DISP_AAL0\0CLK_MM_DISP_GAMMA0\0CLK_MM_DISP_DITHER0\0CLK_MM_DSI_MM_CLOCK\0CLK_MM_DSI_INTERF\0CLK_MM_F26M_HRT\0MDP_WROT0\0DISP_PWM\0MUX_PWM\0CLK26M\0UNIVPLL2_D4\0UNIVPLL2_D8\0UNIVPLL3_D8";
		clocks = <0x1a 0x04 0x1b 0x00 0x1b 0x01 0x1b 0x02 0x1b 0x03 0x1b 0x0c 0x1b 0x0d 0x1b 0x0e 0x1b 0x0f 0x1b 0x10 0x1b 0x11 0x1b 0x12 0x1b 0x13 0x1b 0x14 0x1b 0x15 0x1b 0x18 0x1b 0x09 0x19 0x33 0x24 0x39 0x25 0x24 0x19 0x24 0x1a 0x24 0x1f>;
		compatible = "mediatek,dispsys";
		linux,phandle = <0x55>;
		phandle = <0x55>;
	};

	dramc0@1001d000 {
		compatible = "mediatek,dramc0";
		reg = <0x00 0x1001d000 0x00 0x1000>;
	};

	dramc@1001d000 {
		compatible = "mediatek,dramc";
		reg = <0x00 0x1001d000 0x00 0x1000 0x00 0x1021d000 0x00 0x1000 0x00 0x1001e000 0x00 0x1000>;
	};

	dramc_ch0_rsv@1022e000 {
		compatible = "mediatek,dramc_ch0_rsv";
		reg = <0x00 0x1022e000 0x00 0x2000>;
	};

	dramc_ch0_top0@10228000 {
		compatible = "mediatek,dramc_ch0_top0";
		reg = <0x00 0x10228000 0x00 0x2000>;
	};

	dramc_ch0_top1@1022a000 {
		compatible = "mediatek,dramc_ch0_top1";
		reg = <0x00 0x1022a000 0x00 0x2000>;
	};

	dramc_ch0_top2@1022c000 {
		compatible = "mediatek,dramc_ch0_top2";
		reg = <0x00 0x1022c000 0x00 0x1000>;
	};

	dramc_ch0_top3@1022d000 {
		compatible = "mediatek,dramc_ch0_top3";
		reg = <0x00 0x1022d000 0x00 0x1000>;
	};

	dramc_ch1_rsv@10236000 {
		compatible = "mediatek,dramc_ch1_rsv";
		reg = <0x00 0x10236000 0x00 0x2000>;
	};

	dramc_ch1_top0@10230000 {
		compatible = "mediatek,dramc_ch1_top0";
		reg = <0x00 0x10230000 0x00 0x2000>;
	};

	dramc_ch1_top1@10232000 {
		compatible = "mediatek,dramc_ch1_top1";
		reg = <0x00 0x10232000 0x00 0x2000>;
	};

	dramc_ch1_top2@10234000 {
		compatible = "mediatek,dramc_ch1_top2";
		reg = <0x00 0x10234000 0x00 0x1000>;
	};

	dramc_ch1_top3@10235000 {
		compatible = "mediatek,dramc_ch1_top3";
		reg = <0x00 0x10235000 0x00 0x1000>;
	};

	dramc_nao@1021d000 {
		compatible = "mediatek,dramc_nao";
		reg = <0x00 0x1021d000 0x00 0x1000>;
	};

	dsi0@14012000 {
		compatible = "mediatek,dsi0";
		interrupts = <0x00 0xd1 0x08>;
		reg = <0x00 0x14012000 0x00 0x1000>;
	};

	dsi_te {
		compatible = "mediatek, dsi_te-eint";
		linux,phandle = <0x66>;
		phandle = <0x66>;
		status = "disabled";
	};

	dvfsp@10227000 {
		compatible = "mediatek,dvfsp";
		interrupts = <0x00 0xa3 0x08>;
		reg = <0x00 0x10227000 0x00 0x1000>;
	};

	dvfsrc_top@10012000 {
		compatible = "mediatek,dvfsrc_top";
		reg = <0x00 0x10012000 0x00 0x1000>;
	};

	dxcc_sec@10210000 {
		compatible = "mediatek,dxcc_sec";
		interrupts = <0x00 0xa2 0x04>;
		reg = <0x00 0x10210000 0x00 0x1000>;
	};

	eem_fsm@1100b000 {
		clock-names = "CLK_TOP_MFG\0CLK_TOP_MFG_OFF\0CLK_TOP_MFG_ON\0CG_SCP_SYS_MFG0\0CG_SCP_SYS_MFG1";
		clocks = <0x24 0x2d 0x24 0x00 0x24 0x20 0x1a 0x00 0x1a 0x01>;
		compatible = "mediatek,eem_fsm";
		interrupts = <0x00 0x7d 0x08>;
		reg = <0x00 0x1100b000 0x00 0x1000>;
	};

	efuse_dbg@10004000 {
		compatible = "mediatek,efuse_dbg";
		reg = <0x00 0x10004000 0x00 0x1000>;
	};

	efusec@11c00000 {
		compatible = "mediatek,efusec";
		reg = <0x00 0x11c00000 0x00 0x10000>;
	};

	emi@10219000 {
		compatible = "mediatek,emi";
		interrupts = <0x00 0x90 0x08 0x00 0x91 0x04 0x00 0x98 0x04>;
		reg = <0x00 0x10219000 0x00 0x1000 0x00 0x1021a000 0x00 0x1000 0x00 0x10226000 0x00 0x1000>;
	};

	fhctl@1000ce00 {
		compatible = "mediatek,fhctl";
		reg = <0x00 0x1000ce00 0x00 0x100>;
	};

	fingerprint {
		compatible = "mediatek,goodix-fp";
		linux,phandle = <0x5d>;
		phandle = <0x5d>;
	};

	firmware {

		android {
			compatible = "android,firmware";

			fstab {
				compatible = "android,fstab";

				vendor {
					compatible = "android,vendor";
					dev = "/dev/block/platform/bootdevice/by-name/vendor";
					fsmgr_flags = "wait,verify";
					mnt_flags = "ro";
					type = "ext4";
				};
			};
		};
	};

	flashlight_core {
		compatible = "mediatek,flashlight_core";
		linux,phandle = <0x4f>;
		phandle = <0x4f>;
	};

	flashlights_aw3644 {
		compatible = "mediatek,flashlights_aw3644";
		linux,phandle = <0x51>;
		phandle = <0x51>;
	};

	flashlights_dio5644 {
		compatible = "mediatek,flashlights_dio5644";
		linux,phandle = <0x50>;
		phandle = <0x50>;
	};

	gauge_timer {
		compatible = "mediatek,gauge_timer_service";
	};

	gce@10228000 {
		ap_dma_base = <0x18010000 0x17 0xffff0000>;
		audio_base = <0x17000000 0x12 0xffff0000>;
		buf_underrun_event_0 = <0x8c>;
		buf_underrun_event_1 = <0x8d>;
		camsv_1_pass1_done = <0x107>;
		camsv_2_pass1_done = <0x106>;
		camsys1_base = <0x180a0000 0x1c 0xffff0000>;
		camsys2_base = <0x180b0000 0x1d 0xffff0000>;
		camsys_base = <0x18080000 0x1b 0xffff0000>;
		clock-names = "GCE\0GCE_TIMER";
		clocks = <0x19 0x07 0x19 0x18>;
		compatible = "mediatek,gce";
		conn_peri_base = <0x18820000 0x07 0xffff0000>;
		disp_aal0_frame_done = <0x1c>;
		disp_aal0_sof = <0x0b>;
		disp_ccorr0_frame_done = <0x1b>;
		disp_ccorr0_sof = <0x0a>;
		disp_color0_frame_done = <0x1a>;
		disp_color0_sof = <0x09>;
		disp_dbi0_frame_done = <0x20>;
		disp_dbi0_sof = <0x0f>;
		disp_dither0_frame_done = <0x1e>;
		disp_dither0_sof = <0x0d>;
		disp_dither_base = <0x14010000 0x02 0xffff0000>;
		disp_dsi0_frame_done = <0x1f>;
		disp_dsi0_sof = <0x0e>;
		disp_gamma0_frame_done = <0x1d>;
		disp_gamma0_sof = <0x0c>;
		disp_ovl0 = <0x23>;
		disp_ovl0_frame_done = <0x18>;
		disp_ovl0_frame_rst_done_pusle = <0x99>;
		disp_ovl0_sof = <0x06>;
		disp_pwm0_sof = <0x10>;
		disp_rdma0_frame_done = <0x11>;
		disp_rdma0_sof = <0x07>;
		disp_wdma0_frame_done = <0x19>;
		disp_wdma0_rst_done = <0x94>;
		disp_wdma0_sof = <0x08>;
		dsi0_done_event = <0x90>;
		dsi0_irq_event = <0x8f>;
		dsi0_te_event = <0x8e>;
		g3d_config_base = <0x13000000 0x00 0xffff0000>;
		gce_base = <0x18020000 0x18 0xffff0000>;
		gcpu_base = <0x10050000 0x0f 0xffff0000>;
		imgsys_base = <0x15020000 0x04 0xffff0000>;
		infra_na3_base = <0x10010000 0x0b 0xffff0000>;
		infra_na4_base = <0x10020000 0x0c 0xffff0000>;
		interrupts = <0x00 0x9a 0x08 0x00 0x9b 0x08>;
		isp_frame_done_p1_0 = <0x105>;
		isp_frame_done_p1_1 = <0x104>;
		isp_frame_done_p2_0 = <0x103>;
		isp_frame_done_p2_1 = <0x102>;
		isp_frame_done_p2_2 = <0x101>;
		jpgdec_done = <0x123>;
		jpgenc_done = <0x122>;
		kp_base = <0x18840000 0x09 0xffff0000>;
		max_prefetch_cnt = <0x01>;
		mcucfg_base = <0x10040000 0x0e 0xffff0000>;
		mdp_rdma0 = <0x1c>;
		mdp_rdma0_frame_done = <0x12>;
		mdp_rdma0_rst_done = <0x98>;
		mdp_rdma0_sof = <0x00>;
		mdp_rsz0 = <0x1d>;
		mdp_rsz0_frame_done = <0x13>;
		mdp_rsz0_sof = <0x01>;
		mdp_rsz1 = <0x1e>;
		mdp_rsz1_frame_done = <0x14>;
		mdp_rsz1_sof = <0x02>;
		mdp_tdshp0 = <0x21>;
		mdp_tdshp_frame_done = <0x15>;
		mdp_tdshp_sof = <0x05>;
		mdp_wdma0 = <0x1f>;
		mdp_wdma_frame_done = <0x17>;
		mdp_wdma_rst_done = <0x95>;
		mdp_wdma_sof = <0x03>;
		mdp_wrot0 = <0x20>;
		mdp_wrot0_rst_done = <0x96>;
		mdp_wrot0_sof = <0x04>;
		mdp_wrot0_write_frame_done = <0x16>;
		mm_mutex = <0x22>;
		mm_na_base = <0x14020000 0x03 0xffff0000>;
		mmsys_config = <0x1b>;
		mmsys_config_base = <0x14000000 0x01 0xffff0000>;
		msdc2_base = <0x17020000 0x14 0xffff0000>;
		msdc3_base = <0x18000000 0x16 0xffff0000>;
		prefetch_size = <0x60>;
		pwm_sw_base = <0x11000000 0x63 0xffff0000>;
		reg = <0x00 0x10228000 0x00 0x4000>;
		scp_base = <0x10030000 0x0d 0xffff0000>;
		scp_sram_base = <0x10000000 0x0a 0xffff0000>;
		seninf_cam0_fifo_full = <0x109>;
		seninf_cam1_2_3_fifo_full = <0x108>;
		sram_share_cnt = <0x01>;
		sram_share_engine = <0x08>;
		sram_share_event = <0x2c6>;
		sram_size_cpr_64 = <0x40>;
		stream_done_0 = <0x82>;
		stream_done_1 = <0x83>;
		stream_done_2 = <0x84>;
		stream_done_3 = <0x85>;
		stream_done_4 = <0x86>;
		stream_done_5 = <0x87>;
		stream_done_6 = <0x88>;
		stream_done_7 = <0x89>;
		stream_done_8 = <0x8a>;
		stream_done_9 = <0x8b>;
		topckgen_base = <0x18830000 0x08 0xffff0000>;
		usb0_base = <0x10200000 0x10 0xffff0000>;
		usb_sif_base = <0x10280000 0x11 0xffff0000>;
		vdec1_base = <0x17030000 0x15 0xffff0000>;
		vdec2_base = <0x18040000 0x19 0xffff0000>;
		vdec3_base = <0x18050000 0x1a 0xffff0000>;
		vdec_base = <0x17010000 0x13 0xffff0000>;
		vdec_gcon_base = <0x18800000 0x05 0xffff0000>;
		venc_128byte_cnt_done = <0x125>;
		venc_done = <0x121>;
		venc_gcon_base = <0x18810000 0x06 0xffff0000>;
		venc_mb_done = <0x124>;
	};

	gic500@0c000000 {
		compatible = "mediatek,gic500";
		reg = <0x00 0xc000000 0x00 0x00>;
	};

	gic_cpu@0c400000 {
		compatible = "mediatek,gic_cpu";
		reg = <0x00 0xc400000 0x00 0x40000>;
	};

	gpio {
		compatible = "mediatek,gpio_usage_mapping";
		linux,phandle = <0x3b>;
		phandle = <0x3b>;
	};

	gpio@10005000 {
		compatible = "mediatek,gpio";
		linux,phandle = <0x3c>;
		phandle = <0x3c>;
		reg = <0x00 0x10005000 0x00 0x1000>;
	};

	gps {
		compatible = "mediatek,gps";
	};

	gpufreq {
		clock-names = "CLK_TOP_MFG\0CLK_TOP_MFG_OFF\0CLK_TOP_MFG_ON";
		clocks = <0x24 0x2d 0x25 0x24 0x20>;
		compatible = "mediatek,mt6739-gpufreq";
	};

	gse_1 {
		linux,phandle = <0x5f>;
		phandle = <0x5f>;
	};

	gyro {
		compatible = "mediatek,gyroscope";
		linux,phandle = <0x61>;
		phandle = <0x61>;
	};

	hacc@1000a000 {
		compatible = "mediatek,hacc";
		interrupts = <0x00 0xb5 0x08>;
		reg = <0x00 0x1000a000 0x00 0x1000>;
	};

	i2c@11007000 {
		aed = <0x1f>;
		clock-div = <0x05>;
		clock-names = "main\0dma";
		clocks = <0x19 0x09 0x19 0x28>;
		compatible = "mediatek,mt6739-i2c";
		id = <0x00>;
		interrupts = <0x00 0x54 0x08>;
		linux,phandle = <0x42>;
		phandle = <0x42>;
		reg = <0x00 0x11007000 0x00 0x1000 0x00 0x11000100 0x00 0x80>;
	};

	i2c@11008000 {
		aed = <0x1f>;
		clock-div = <0x05>;
		clock-names = "main\0dma";
		clocks = <0x19 0x0a 0x19 0x28>;
		compatible = "mediatek,mt6739-i2c";
		id = <0x01>;
		interrupts = <0x00 0x55 0x08>;
		linux,phandle = <0x43>;
		phandle = <0x43>;
		reg = <0x00 0x11008000 0x00 0x1000 0x00 0x11000180 0x00 0x80>;
	};

	i2c@11009000 {
		aed = <0x1f>;
		clock-div = <0x05>;
		clock-names = "main\0dma";
		clocks = <0x19 0x0b 0x19 0x28>;
		compatible = "mediatek,mt6739-i2c";
		id = <0x02>;
		interrupts = <0x00 0x56 0x08>;
		linux,phandle = <0x44>;
		phandle = <0x44>;
		reg = <0x00 0x11009000 0x00 0x1000 0x00 0x11000200 0x00 0x80>;
	};

	i2c@1100f000 {
		aed = <0x1f>;
		clock-div = <0x05>;
		clock-names = "main\0dma";
		clocks = <0x19 0x0c 0x19 0x28>;
		compatible = "mediatek,mt6739-i2c";
		id = <0x03>;
		interrupts = <0x00 0x57 0x08>;
		linux,phandle = <0x45>;
		phandle = <0x45>;
		reg = <0x00 0x1100f000 0x00 0x1000 0x00 0x11000280 0x00 0x80>;
	};

	i2c@11011000 {
		aed = <0x1f>;
		clock-div = <0x05>;
		clock-names = "main\0dma";
		clocks = <0x19 0x37 0x19 0x28>;
		compatible = "mediatek,mt6739-i2c";
		id = <0x04>;
		interrupts = <0x00 0x58 0x08>;
		linux,phandle = <0x46>;
		phandle = <0x46>;
		reg = <0x00 0x11011000 0x00 0x1000 0x00 0x11000300 0x00 0x80>;
	};

	i2c@11016000 {
		aed = <0x1f>;
		clock-div = <0x05>;
		clock-names = "main\0dma";
		clocks = <0x19 0x3b 0x19 0x28>;
		compatible = "mediatek,mt6739-i2c";
		id = <0x05>;
		interrupts = <0x00 0x82 0x08>;
		linux,phandle = <0x47>;
		phandle = <0x47>;
		reg = <0x00 0x11016000 0x00 0x1000 0x00 0x11000380 0x00 0x80>;
	};

	imgsys_config@15000000 {
		#clock-cells = <0x01>;
		compatible = "mediatek,imgsys\0syscon";
		linux,phandle = <0x36>;
		phandle = <0x36>;
		reg = <0x00 0x15000000 0x00 0x1000>;
	};

	infra_mbist@1020d000 {
		compatible = "mediatek,infra_mbist";
		reg = <0x00 0x1020d000 0x00 0x1000>;
	};

	infracfg@1020e000 {
		compatible = "mediatek,infracfg";
		reg = <0x00 0x1020e000 0x00 0x1000>;
	};

	infracfg_ao@10001000 {
		#clock-cells = <0x01>;
		compatible = "mediatek,infracfg_ao\0syscon";
		interrupts = <0x00 0x93 0x01>;
		linux,phandle = <0x19>;
		phandle = <0x19>;
		reg = <0x00 0x10001000 0x00 0x1000>;
	};

	interrupt-controller@0c000000 {
		#address-cells = <0x02>;
		#interrupt-cells = <0x03>;
		#redistributor-regions = <0x01>;
		#size-cells = <0x02>;
		compatible = "arm,gic-v3";
		interrupt-controller;
		interrupt-parent = <0x02>;
		interrupts = <0x01 0x09 0x04>;
		linux,phandle = <0x02>;
		mediatek,reg_len_pol0 = <0x08>;
		phandle = <0x02>;
		reg = <0x00 0xc000000 0x00 0x40000 0x00 0xc080000 0x00 0x200000 0x00 0x10200620 0x00 0x1000>;
	};

	intpol-controller@0x10200620 {
		#interrupt-cells = <0x03>;
		compatible = "mediatek,mt6739-sysirq\0mediatek,mt6577-sysirq";
		interrupt-controller;
		interrupt-parent = <0x02>;
		linux,phandle = <0x01>;
		phandle = <0x01>;
		reg = <0x00 0x10200620 0x00 0x20>;
	};

	io_cfg_bl@10002600 {
		compatible = "mediatek,io_cfg_bl";
		reg = <0x00 0x10002600 0x00 0x200>;
	};

	io_cfg_bm@10002800 {
		compatible = "mediatek,io_cfg_bm";
		reg = <0x00 0x10002800 0x00 0x200>;
	};

	io_cfg_lb@10002400 {
		compatible = "mediatek,io_cfg_lb";
		reg = <0x00 0x10002400 0x00 0x200>;
	};

	io_cfg_lm@10002200 {
		compatible = "mediatek,io_cfg_lm";
		reg = <0x00 0x10002200 0x00 0x200>;
	};

	io_cfg_lt@10002000 {
		compatible = "mediatek,io_cfg_lt";
		reg = <0x00 0x10002000 0x00 0x200>;
	};

	io_cfg_rb@10002a00 {
		compatible = "mediatek,io_cfg_rb";
		reg = <0x00 0x10002a00 0x00 0x200>;
	};

	io_cfg_rt@10002c00 {
		compatible = "mediatek,io_cfg_rt";
		reg = <0x00 0x10002c00 0x00 0x200>;
	};

	iocfg_0@10002000 {
		compatible = "mediatek,iocfg_0";
		reg = <0x00 0x10002000 0x00 0x200>;
	};

	iocfg_1@10002200 {
		compatible = "mediatek,iocfg_1";
		reg = <0x00 0x10002200 0x00 0x200>;
	};

	iocfg_2@10002400 {
		compatible = "mediatek,iocfg_2";
		reg = <0x00 0x10002400 0x00 0x200>;
	};

	iocfg_3@10002600 {
		compatible = "mediatek,iocfg_3";
		reg = <0x00 0x10002600 0x00 0x200>;
	};

	iocfg_4@10002800 {
		compatible = "mediatek,iocfg_4";
		reg = <0x00 0x10002800 0x00 0x200>;
	};

	iocfg_5@10002a00 {
		compatible = "mediatek,iocfg_5";
		reg = <0x00 0x10002a00 0x00 0x200>;
	};

	irq_nfc {
		compatible = "mediatek,irq_nfc-eint";
		linux,phandle = <0x6a>;
		phandle = <0x6a>;
	};

	irtx@1100d000 {
		compatible = "mediatek,irtx";
		interrupts = <0x00 0x7f 0x08>;
		reg = <0x00 0x1100d000 0x00 0x1000>;
	};

	irtx_pwm {
		compatible = "mediatek,irtx-pwm";
		linux,phandle = <0x6d>;
		phandle = <0x6d>;
		pwm_ch = <0x01>;
		pwm_data_invert = <0x00>;
	};

	ispsys@15000000 {
		clock-names = "CG_SCP_SYS_MM0\0CG_SCP_SYS_ISP\0CG_IMG_CAM_SMI\0CG_IMG_CAM_CAM\0CG_IMG_SEN_TG\0CG_IMG_SEN_CAM\0CG_IMG_CAM_SV";
		clocks = <0x1a 0x04 0x1a 0x05 0x36 0x01 0x36 0x02 0x36 0x03 0x36 0x04 0x36 0x05>;
		compatible = "mediatek,mt6739-ispsys";
		interrupts = <0x00 0xd9 0x08 0x00 0xda 0x08 0x00 0xdb 0x08 0x00 0xdc 0x08 0x00 0xdd 0x08>;
		reg = <0x00 0x15004000 0x00 0x9000 0x00 0x1500d000 0x00 0x1000 0x00 0x15000000 0x00 0x10000 0x00 0x10215000 0x00 0x3000 0x00 0x10211000 0x00 0x1000>;
	};

	kd_camera_hw1@15008000 {
		clock-names = "CLK_TOP_CAMTG_SEL\0CLK_TOP_CAMTG2_SEL\0CLK_TOP_CLK26M\0CLK_TOP_UNIVPLL_48M_D2\0CLK_TOP_UNIVPLL2_D8\0CLK_TOP_UNIVPLL_D26\0CLK_TOP_UNIVPLL2_D32\0CLK_TOP_UNIVPLL_48M_D4\0CLK_TOP_UNIVPLL_48M_D8\0CLK_TOP_SENINF_SEL\0CLK_TOP_SCAM_SEL";
		clocks = <0x24 0x2e 0x24 0x41 0x25 0x24 0x11 0x24 0x1a 0x24 0x10 0x24 0x1b 0x24 0x12 0x24 0x13 0x24 0x3f 0x24 0x37>;
		compatible = "mediatek,camera_hw";
		linux,phandle = <0x67>;
		phandle = <0x67>;
		reg = <0x00 0x15008000 0x00 0x1000>;
	};

	kp@10010000 {
		compatible = "mediatek,kp";
		interrupts = <0x00 0xb0 0x02>;
		linux,phandle = <0x16>;
		phandle = <0x16>;
		reg = <0x00 0x10010000 0x00 0x1000>;
	};

	m4u@10205000 {
		cell-index = <0x00>;
		compatible = "mediatek,m4u";
		interrupts = <0x00 0x9e 0x08>;
		reg = <0x00 0x10205000 0x00 0x1000>;
	};

	mbist_ao@10013000 {
		compatible = "mediatek,mbist_ao";
		reg = <0x00 0x10013000 0x00 0x1000>;
	};

	mcdi@10216000 {
		compatible = "mediatek,mt6739-mcdi";
		reg = <0x00 0x10fc00 0x00 0x400 0x00 0x10216000 0x00 0x1000 0x00 0x10217000 0x00 0x2000>;
	};

	mcucfg@10200000 {
		compatible = "mediatek,mcucfg";
		interrupts = <0x00 0x00 0x08>;
		reg = <0x00 0x10200000 0x00 0x1000>;
	};

	md1_sim1_hot_plug_eint {
		linux,phandle = <0x6b>;
		phandle = <0x6b>;
	};

	md1_sim2_hot_plug_eint {
		linux,phandle = <0x6c>;
		phandle = <0x6c>;
	};

	md2md_md1_ccif0@10211000 {
		compatible = "mediatek,md2md_md1_ccif0";
		reg = <0x00 0x10211000 0x00 0x1000>;
	};

	md2md_md2_ccif0@10213000 {
		compatible = "mediatek,md2md_md2_ccif0";
		reg = <0x00 0x10213000 0x00 0x1000>;
	};

	md_ccif0@1020a000 {
		compatible = "mediatek,md_ccif0";
		reg = <0x00 0x1020a000 0x00 0x1000>;
	};

	md_ccif1@1020c000 {
		compatible = "mediatek,md_ccif1";
		reg = <0x00 0x1020c000 0x00 0x1000>;
	};

	mdcldma@10014000 {
		clock-names = "scp-sys-md1-main\0infra-cldma-bclk\0infra-ccif-ap\0infra-ccif-md\0infra-ccif1-ap\0infra-ccif1-md";
		clocks = <0x1a 0x02 0x19 0x34 0x19 0x2b 0x19 0x2e 0x19 0x24 0x19 0x25>;
		compatible = "mediatek,mdcldma";
		interrupts = <0x00 0xa5 0x04 0x00 0x94 0x08 0x00 0x95 0x08 0x00 0xe3 0x02>;
		linux,phandle = <0x17>;
		mediatek,cldma_capability = <0x06>;
		mediatek,md_id = <0x00>;
		phandle = <0x17>;
		reg = <0x00 0x10014000 0x00 0x1000 0x00 0x1021b000 0x00 0x1000 0x00 0x10209000 0x00 0x1000 0x00 0x1020a000 0x00 0x1000>;
	};

	mdcldmain@1021c000 {
		compatible = "mediatek,mdcldmain";
		reg = <0x00 0x1021c000 0x00 0x400>;
	};

	mdcldmain_ao@10015000 {
		compatible = "mediatek,mdcldmain_ao";
		reg = <0x00 0x10015000 0x00 0x400>;
	};

	mdcldmamisc@1021c000 {
		compatible = "mediatek,mdcldmamisc";
		reg = <0x00 0x1021c000 0x00 0x00>;
	};

	mdcldmamisc@1021c900 {
		compatible = "mediatek,mdcldmamisc";
		reg = <0x00 0x1021c900 0x00 0x400>;
	};

	mdcldmamisc_ao@10015800 {
		compatible = "mediatek,mdcldmamisc_ao";
		reg = <0x00 0x10015800 0x00 0x400>;
	};

	mdcldmaout@1021c400 {
		compatible = "mediatek,mdcldmaout";
		reg = <0x00 0x1021c400 0x00 0x400>;
	};

	mdcldmaout_ao@10015400 {
		compatible = "mediatek,mdcldmaout_ao";
		reg = <0x00 0x10015400 0x00 0x400>;
	};

	mdp_rdma0@14004000 {
		clock-names = "MDP_RDMA0";
		clocks = <0x1b 0x05>;
		compatible = "mediatek,mdp_rdma0";
		interrupts = <0x00 0xc3 0x08>;
		linux,phandle = <0x1c>;
		phandle = <0x1c>;
		reg = <0x00 0x14004000 0x00 0x1000>;
	};

	mdp_rsz0@14005000 {
		clock-names = "MDP_RSZ0";
		clocks = <0x1b 0x06>;
		compatible = "mediatek,mdp_rsz0";
		interrupts = <0x00 0xc4 0x08>;
		linux,phandle = <0x1d>;
		phandle = <0x1d>;
		reg = <0x00 0x14005000 0x00 0x1000>;
	};

	mdp_rsz1@14006000 {
		clock-names = "MDP_RSZ1";
		clocks = <0x1b 0x07>;
		compatible = "mediatek,mdp_rsz1";
		interrupts = <0x00 0xc5 0x08>;
		linux,phandle = <0x1e>;
		phandle = <0x1e>;
		reg = <0x00 0x14006000 0x00 0x1000>;
	};

	mdp_tdshp0@14009000 {
		clock-names = "MDP_TDSHP";
		clocks = <0x1b 0x08>;
		compatible = "mediatek,mdp_tdshp0";
		linux,phandle = <0x21>;
		phandle = <0x21>;
		reg = <0x00 0x14009000 0x00 0x1000>;
	};

	mdp_wdma0@14007000 {
		clock-names = "MDP_WDMA";
		clocks = <0x1b 0x0a>;
		compatible = "mediatek,mdp_wdma0";
		interrupts = <0x00 0xc8 0x08>;
		linux,phandle = <0x1f>;
		phandle = <0x1f>;
		reg = <0x00 0x14007000 0x00 0x1000>;
	};

	mdp_wrot0@14008000 {
		clock-names = "MDP_WROT0";
		clocks = <0x1b 0x09>;
		compatible = "mediatek,mdp_wrot0";
		interrupts = <0x00 0xc7 0x08>;
		linux,phandle = <0x20>;
		phandle = <0x20>;
		reg = <0x00 0x14008000 0x00 0x1000>;
	};

	memory {
		device_type = "memory";
		reg = <0x00 0x40000000 0x00 0x20000000>;
	};

	mfg_auckland@13000000 {
		clock-frequency = <0x21f98280>;
		clock-names = "CLK_TOP_MFG\0CLK_TOP_MFG_OFF\0CLK_TOP_MFG_ON\0CG_SCP_SYS_MFG0\0CG_SCP_SYS_MFG1";
		clocks = <0x24 0x2d 0x25 0x24 0x20 0x1a 0x00 0x1a 0x01>;
		compatible = "mediatek,AUCKLAND";
		interrupt-names = "RGX";
		interrupts = <0x00 0xe2 0x08>;
		reg = <0x00 0x13000000 0x00 0x80000>;
	};

	mfg_cfg@13ffe000 {
		compatible = "mediatek,mt6739-mfg_cfg\0syscon";
		reg = <0x00 0x13ffe000 0x00 0x1000>;
	};

	mipi_rx_ana_csi0@11c10000 {
		compatible = "mediatek,mipi_rx_ana_csi0";
		reg = <0x00 0x11c10000 0x00 0x10000>;
	};

	mipi_rx_ana_csi1@11c20000 {
		compatible = "mediatek,mipi_rx_ana_csi1";
		reg = <0x00 0x11c20000 0x00 0x10000>;
	};

	mipi_tx0@11c80000 {
		compatible = "mediatek,mipi_tx0";
		reg = <0x00 0x11c80000 0x00 0x1000>;
	};

	mm_mutex@14016000 {
		compatible = "mediatek,mm_mutex";
		linux,phandle = <0x56>;
		phandle = <0x56>;
		reg = <0x00 0x14016000 0x00 0x00>;
	};

	mmsys_config@14000000 {
		#clock-cells = <0x01>;
		clock-names = "CAM_MDP";
		clocks = <0x1b 0x04>;
		compatible = "mediatek,mmsys_config\0syscon";
		interrupts = <0x00 0xd3 0x08>;
		linux,phandle = <0x1b>;
		phandle = <0x1b>;
		reg = <0x00 0x14000000 0x00 0x1000>;
	};

	mobicore {
		compatible = "trustonic,mobicore";
		interrupts = <0x00 0x6e 0x01>;
	};

	modem_temp_share@10018000 {
		compatible = "mediatek,modem_temp_share";
		reg = <0x00 0x10018000 0x00 0x1000>;
	};

	mrdump_ext_rst {
		compatible = "mediatek, mrdump_ext_rst-eint";
		linux,phandle = <0x62>;
		mode = "IRQ";
		phandle = <0x62>;
		source = "EINT";
		status = "okay";
	};

	msdc0_pad_macro@11cd0000 {
		compatible = "mediatek,msdc0_pad_macro";
		reg = <0x00 0x11cd0000 0x00 0x10000>;
	};

	msdc1_ins {
		linux,phandle = <0x63>;
		phandle = <0x63>;
	};

	msdc1_pad_macro@11c40000 {
		compatible = "mediatek,msdc1_pad_macro";
		reg = <0x00 0x11c40000 0x00 0x10000>;
	};

	msdc@11230000 {
		bus-width = <0x08>;
		cap-mmc-highspeed;
		clk_src = [01];
		clock-names = "msdc0-clock\0msdc0-hclock";
		clocks = <0x19 0x4b 0x19 0x1c>;
		compatible = "mediatek,msdc";
		host_function = [00];
		hw_dvfs = [00];
		index = [00];
		interrupts = <0x00 0x4f 0x08>;
		linux,phandle = <0x4b>;
		max-frequency = <0xbebc200>;
		mmc-ddr-1_8v;
		mmc-hs200-1_8v;
		mmc-hs400-1_8v;
		msdc-sys-suspend;
		non-removable;
		phandle = <0x4b>;
		pinctl = <0x26>;
		reg = <0x00 0x11230000 0x00 0x10000 0x00 0x11cd0000 0x00 0x10000>;
		register_setting = <0x27>;
		status = "okay";
		vmmc-supply = <0x28>;

		msdc0@default {
			linux,phandle = <0x26>;
			phandle = <0x26>;

			pins_clk {
				drive-strength = [04];
			};

			pins_cmd {
				drive-strength = [04];
			};

			pins_dat {
				drive-strength = [04];
			};

			pins_ds {
				drive-strength = [04];
			};

			pins_rst {
				drive-strength = [04];
			};
		};

		msdc0@register_default {
			cmd_edge = [00];
			linux,phandle = <0x27>;
			phandle = <0x27>;
			rdata_edge = [00];
			wdata_edge = [00];
		};
	};

	msdc@11240000 {
		bus-width = <0x04>;
		cap-sd-highspeed;
		cd-gpios = <0x2e 0x0e 0x00>;
		cd_level = [00];
		clk_src = [02];
		clock-names = "msdc1-clock\0msdc1-hclock";
		clocks = <0x19 0x4c 0x19 0x1d>;
		compatible = "mediatek,msdc";
		host_function = [01];
		hw_dvfs = [00];
		index = [01];
		interrupts = <0x00 0x50 0x08>;
		linux,phandle = <0x4c>;
		max-frequency = <0xbebc200>;
		msdc-sys-suspend;
		phandle = <0x4c>;
		pinctl = <0x29>;
		pinctl_ddr50 = <0x2c>;
		pinctl_sdr104 = <0x2a>;
		pinctl_sdr50 = <0x2b>;
		reg = <0x00 0x11240000 0x00 0x10000 0x00 0x11c40000 0x00 0x10000>;
		register_setting = <0x2d>;
		sd-uhs-ddr50;
		sd-uhs-sdr104;
		sd-uhs-sdr12;
		sd-uhs-sdr25;
		sd-uhs-sdr50;
		status = "okay";
		vmmc-supply = <0x2f>;
		vqmmc-supply = <0x30>;

		msdc1@ddr50 {
			linux,phandle = <0x2c>;
			phandle = <0x2c>;

			pins_clk {
				drive-strength = [03];
			};

			pins_cmd {
				drive-strength = [03];
			};

			pins_dat {
				drive-strength = [03];
			};
		};

		msdc1@default {
			linux,phandle = <0x29>;
			phandle = <0x29>;

			pins_clk {
				drive-strength = [03];
			};

			pins_cmd {
				drive-strength = [03];
			};

			pins_dat {
				drive-strength = [03];
			};
		};

		msdc1@register_default {
			cmd_edge = [00];
			linux,phandle = <0x2d>;
			phandle = <0x2d>;
			rdata_edge = [00];
			wdata_edge = [00];
		};

		msdc1@sdr104 {
			linux,phandle = <0x2a>;
			phandle = <0x2a>;

			pins_clk {
				drive-strength = [03];
			};

			pins_cmd {
				drive-strength = [03];
			};

			pins_dat {
				drive-strength = [03];
			};
		};

		msdc1@sdr50 {
			linux,phandle = <0x2b>;
			phandle = <0x2b>;

			pins_clk {
				drive-strength = [03];
			};

			pins_cmd {
				drive-strength = [03];
			};

			pins_dat {
				drive-strength = [03];
			};
		};
	};

	mse {
		linux,phandle = <0x60>;
		phandle = <0x60>;
	};

	mt6357_gauge {
		alias_name = "mt6357";
		compatible = "mediatek,mt6357_gauge";
		gauge_name = "gauge";
	};

	mt_charger {
		compatible = "mediatek,mt-charger";
		linux,phandle = <0x59>;
		phandle = <0x59>;
	};

	mt_pmic_regulator {
		compatible = "mediatek,mt_pmic";

		buck_regulators {
			compatible = "mediatek,mt_pmic_buck_regulators";

			buck_vcore {
				linux,phandle = <0x71>;
				phandle = <0x71>;
				regulator-enable-ramp-delay = <0xdc>;
				regulator-max-microvolt = <0x123716>;
				regulator-min-microvolt = <0x7ea5e>;
				regulator-name = "vcore";
				regulator-ramp-delay = <0x186a>;
			};

			buck_vmodem {
				linux,phandle = <0x70>;
				phandle = <0x70>;
				regulator-enable-ramp-delay = <0xdc>;
				regulator-max-microvolt = <0x123716>;
				regulator-min-microvolt = <0x7a120>;
				regulator-name = "vmodem";
				regulator-ramp-delay = <0x186a>;
			};

			buck_vpa {
				linux,phandle = <0x73>;
				phandle = <0x73>;
				regulator-enable-ramp-delay = <0xdc>;
				regulator-max-microvolt = <0x37b1d0>;
				regulator-min-microvolt = <0x7a120>;
				regulator-name = "vpa";
				regulator-ramp-delay = <0xc350>;
			};

			buck_vproc {
				linux,phandle = <0x72>;
				phandle = <0x72>;
				regulator-enable-ramp-delay = <0xdc>;
				regulator-max-microvolt = <0x1406f4>;
				regulator-min-microvolt = <0x7ea5e>;
				regulator-name = "vproc";
				regulator-ramp-delay = <0x186a>;
			};

			buck_vs1 {
				linux,phandle = <0x6f>;
				phandle = <0x6f>;
				regulator-enable-ramp-delay = <0xdc>;
				regulator-max-microvolt = <0x2191c0>;
				regulator-min-microvolt = <0x124f80>;
				regulator-name = "vs1";
				regulator-ramp-delay = <0x30d4>;
			};
		};

		ldo_regulators {
			compatible = "mediatek,mt_pmic_ldo_regulators";

			ldo_vaud28 {
				compatible = "regulator-fixed";
				linux,phandle = <0x84>;
				phandle = <0x84>;
				regulator-enable-ramp-delay = <0x108>;
				regulator-max-microvolt = <0x2ab980>;
				regulator-min-microvolt = <0x2ab980>;
				regulator-name = "vaud28";
			};

			ldo_vaux18 {
				compatible = "regulator-fixed";
				linux,phandle = <0x83>;
				phandle = <0x83>;
				regulator-enable-ramp-delay = <0x108>;
				regulator-max-microvolt = <0x1b7740>;
				regulator-min-microvolt = <0x1b7740>;
				regulator-name = "vaux18";
			};

			ldo_vcama {
				linux,phandle = <0x7d>;
				phandle = <0x7d>;
				regulator-enable-ramp-delay = <0x108>;
				regulator-max-microvolt = <0x2ab980>;
				regulator-min-microvolt = <0x2625a0>;
				regulator-name = "vcama";
			};

			ldo_vcamd {
				linux,phandle = <0x7e>;
				phandle = <0x7e>;
				regulator-enable-ramp-delay = <0x108>;
				regulator-max-microvolt = <0x1b7740>;
				regulator-min-microvolt = <0xf4240>;
				regulator-name = "vcamd";
			};

			ldo_vcamio {
				compatible = "regulator-fixed";
				linux,phandle = <0x7f>;
				phandle = <0x7f>;
				regulator-enable-ramp-delay = <0x108>;
				regulator-max-microvolt = <0x1b7740>;
				regulator-min-microvolt = <0x1b7740>;
				regulator-name = "vcamio";
			};

			ldo_vcn18 {
				compatible = "regulator-fixed";
				linux,phandle = <0x7c>;
				phandle = <0x7c>;
				regulator-enable-ramp-delay = <0x108>;
				regulator-max-microvolt = <0x1b7740>;
				regulator-min-microvolt = <0x1b7740>;
				regulator-name = "vcn18";
			};

			ldo_vcn28 {
				compatible = "regulator-fixed";
				linux,phandle = <0x7b>;
				phandle = <0x7b>;
				regulator-enable-ramp-delay = <0x108>;
				regulator-max-microvolt = <0x2ab980>;
				regulator-min-microvolt = <0x2ab980>;
				regulator-name = "vcn28";
			};

			ldo_vcn33_bt {
				linux,phandle = <0x79>;
				phandle = <0x79>;
				regulator-enable-ramp-delay = <0x108>;
				regulator-max-microvolt = <0x3567e0>;
				regulator-min-microvolt = <0x325aa0>;
				regulator-name = "vcn33_bt";
			};

			ldo_vcn33_wifi {
				linux,phandle = <0x7a>;
				phandle = <0x7a>;
				regulator-enable-ramp-delay = <0x108>;
				regulator-max-microvolt = <0x3567e0>;
				regulator-min-microvolt = <0x325aa0>;
				regulator-name = "vcn33_wifi";
			};

			ldo_vdram {
				linux,phandle = <0x87>;
				phandle = <0x87>;
				regulator-enable-ramp-delay = <0xce4>;
				regulator-max-microvolt = <0x124f80>;
				regulator-min-microvolt = <0x10c8e0>;
				regulator-name = "vdram";
			};

			ldo_vefuse {
				linux,phandle = <0x78>;
				phandle = <0x78>;
				regulator-enable-ramp-delay = <0x108>;
				regulator-max-microvolt = <0x325aa0>;
				regulator-min-microvolt = <0x124f80>;
				regulator-name = "vefuse";
			};

			ldo_vemc {
				linux,phandle = <0x28>;
				phandle = <0x28>;
				regulator-enable-ramp-delay = <0x2c>;
				regulator-max-microvolt = <0x325aa0>;
				regulator-min-microvolt = <0x2c4020>;
				regulator-name = "vemc";
			};

			ldo_vfe28 {
				compatible = "regulator-fixed";
				linux,phandle = <0x74>;
				phandle = <0x74>;
				regulator-enable-ramp-delay = <0x108>;
				regulator-max-microvolt = <0x2ab980>;
				regulator-min-microvolt = <0x2ab980>;
				regulator-name = "vfe28";
			};

			ldo_vibr {
				linux,phandle = <0x8a>;
				phandle = <0x8a>;
				regulator-enable-ramp-delay = <0x2c>;
				regulator-max-microvolt = <0x325aa0>;
				regulator-min-microvolt = <0x124f80>;
				regulator-name = "vibr";
			};

			ldo_vio18 {
				compatible = "regulator-fixed";
				linux,phandle = <0x86>;
				phandle = <0x86>;
				regulator-enable-ramp-delay = <0x108>;
				regulator-max-microvolt = <0x1b7740>;
				regulator-min-microvolt = <0x1b7740>;
				regulator-name = "vio18";
			};

			ldo_vio28 {
				compatible = "regulator-fixed";
				linux,phandle = <0x85>;
				phandle = <0x85>;
				regulator-enable-ramp-delay = <0x108>;
				regulator-max-microvolt = <0x2ab980>;
				regulator-min-microvolt = <0x2ab980>;
				regulator-name = "vio28";
			};

			ldo_vldo28 {
				linux,phandle = <0x80>;
				phandle = <0x80>;
				regulator-enable-ramp-delay = <0x108>;
				regulator-max-microvolt = <0x2dc6c0>;
				regulator-min-microvolt = <0x2ab980>;
				regulator-name = "vldo28";
			};

			ldo_vmc {
				linux,phandle = <0x30>;
				phandle = <0x30>;
				regulator-enable-ramp-delay = <0x2c>;
				regulator-max-microvolt = <0x325aa0>;
				regulator-min-microvolt = <0x1b7740>;
				regulator-name = "vmc";
			};

			ldo_vmch {
				linux,phandle = <0x2f>;
				phandle = <0x2f>;
				regulator-enable-ramp-delay = <0x2c>;
				regulator-max-microvolt = <0x325aa0>;
				regulator-min-microvolt = <0x2c4020>;
				regulator-name = "vmch";
			};

			ldo_vrf12 {
				compatible = "regulator-fixed";
				linux,phandle = <0x77>;
				phandle = <0x77>;
				regulator-enable-ramp-delay = <0x6e>;
				regulator-max-microvolt = <0x124f80>;
				regulator-min-microvolt = <0x124f80>;
				regulator-name = "vrf12";
			};

			ldo_vrf18 {
				compatible = "regulator-fixed";
				linux,phandle = <0x76>;
				phandle = <0x76>;
				regulator-enable-ramp-delay = <0x6e>;
				regulator-max-microvolt = <0x1b7740>;
				regulator-min-microvolt = <0x1b7740>;
				regulator-name = "vrf18";
			};

			ldo_vsim1 {
				linux,phandle = <0x88>;
				phandle = <0x88>;
				regulator-enable-ramp-delay = <0x108>;
				regulator-max-microvolt = <0x2f4d60>;
				regulator-min-microvolt = <0x19f0a0>;
				regulator-name = "vsim1";
			};

			ldo_vsim2 {
				linux,phandle = <0x89>;
				phandle = <0x89>;
				regulator-enable-ramp-delay = <0x108>;
				regulator-max-microvolt = <0x2f4d60>;
				regulator-min-microvolt = <0x19f0a0>;
				regulator-name = "vsim2";
			};

			ldo_vsram_others {
				linux,phandle = <0x81>;
				phandle = <0x81>;
				regulator-enable-ramp-delay = <0x6e>;
				regulator-max-microvolt = <0x1406f4>;
				regulator-min-microvolt = <0x7ea5e>;
				regulator-name = "vsram_others";
				regulator-ramp-delay = <0x186a>;
			};

			ldo_vsram_proc {
				linux,phandle = <0x82>;
				phandle = <0x82>;
				regulator-enable-ramp-delay = <0x6e>;
				regulator-max-microvolt = <0x1406f4>;
				regulator-min-microvolt = <0x7ea5e>;
				regulator-name = "vsram_proc";
				regulator-ramp-delay = <0x186a>;
			};

			ldo_vusb33 {
				linux,phandle = <0x8b>;
				phandle = <0x8b>;
				regulator-enable-ramp-delay = <0x108>;
				regulator-max-microvolt = <0x2f4d60>;
				regulator-min-microvolt = <0x2dc6c0>;
				regulator-name = "vusb33";
			};

			ldo_vxo22 {
				linux,phandle = <0x75>;
				phandle = <0x75>;
				regulator-enable-ramp-delay = <0x6e>;
				regulator-max-microvolt = <0x249f00>;
				regulator-min-microvolt = <0x2191c0>;
				regulator-name = "vxo22";
			};
		};
	};

	mt_soc_anc_pcm {
		compatible = "mediatek,mt_soc_pcm_anc";
	};

	mt_soc_btcvsd_rx_pcm {
		compatible = "mediatek,mt_soc_btcvsd_rx_pcm";
	};

	mt_soc_btcvsd_tx_pcm {
		compatible = "mediatek,mt_soc_btcvsd_tx_pcm";
	};

	mt_soc_codec_dummy_name {
		compatible = "mediatek,mt_soc_codec_dummy";
	};

	mt_soc_codec_name {
		compatible = "mediatek,mt_soc_codec_63xx";
		use_hp_depop_flow = <0x00>;
		use_ul_260k = <0x00>;
	};

	mt_soc_dai_name {
		compatible = "mediatek,mt_soc_dai_stub";
	};

	mt_soc_deep_buffer_dl_pcm {
		compatible = "mediatek,mt_soc_pcm_deep_buffer_dl";
	};

	mt_soc_dl1_awb_pcm {
		compatible = "mediatek,mt_soc_pcm_dl1_awb";
	};

	mt_soc_dl1_pcm@11220000 {
		clock-names = "aud_afe_clk\0aud_dac_clk\0aud_dac_predis_clk\0aud_adc_clk\0aud_apll22m_clk\0aud_apll1_tuner_clk\0aud_tml_clk\0aud_infra_clk\0mtkaif_26m_clk\0top_mux_audio\0top_mux_audio_int\0top_sys_pll1_d4\0top_mux_aud_1\0top_apll1_ck\0top_mux_aud_eng1\0top_apll1_d8\0apmixed_apll1\0top_clk26m_clk";
		clocks = <0x31 0x00 0x31 0x04 0x31 0x05 0x31 0x03 0x31 0x01 0x31 0x02 0x31 0x06 0x19 0x2d 0x19 0x35 0x24 0x34 0x24 0x35 0x24 0x03 0x24 0x38 0x24 0x24 0x24 0x42 0x24 0x27 0x32 0x06 0x25>;
		compatible = "mediatek,mt_soc_pcm_dl1";
		interrupts = <0x00 0x99 0x08>;
		linux,phandle = <0x4d>;
		phandle = <0x4d>;
		reg = <0x00 0x11220000 0x00 0x1000>;
	};

	mt_soc_dl2_pcm {
		compatible = "mediatek,mt_soc_pcm_dl2";
	};

	mt_soc_dummy_pcm {
		compatible = "mediatek,mt_soc_pcm_dummy";
	};

	mt_soc_fm_i2s_awb_pcm {
		compatible = "mediatek,mt_soc_pcm_fm_i2s_awb";
	};

	mt_soc_fm_i2s_pcm {
		compatible = "mediatek,mt_soc_pcm_fm_i2s";
	};

	mt_soc_fm_mrgtx_pcm {
		compatible = "mediatek,mt_soc_pcm_fmtx";
	};

	mt_soc_hdmi_pcm {
		compatible = "mediatek,mt_soc_pcm_hdmi";
	};

	mt_soc_hp_impedance_pcm {
		compatible = "mediatek,mt_soc_pcm_hp_impedance";
	};

	mt_soc_i2s0_awb_pcm {
		compatible = "mediatek,mt_soc_pcm_i2s0_awb";
	};

	mt_soc_i2s0_pcm {
		compatible = "mediatek,mt_soc_pcm_dl1_i2s0";
	};

	mt_soc_i2s0dl1_pcm {
		compatible = "mediatek,mt_soc_pcm_dl1_i2s0dl1";
	};

	mt_soc_mrgrx_awb_pcm {
		compatible = "mediatek,mt_soc_pcm_mrgrx_awb";
	};

	mt_soc_mrgrx_pcm {
		compatible = "mediatek,mt_soc_pcm_mrgrx";
	};

	mt_soc_pcm_voice_ultra {
		compatible = "mediatek,mt_soc_pcm_voice_ultra";
	};

	mt_soc_pcm_voice_usb {
		compatible = "mediatek,mt_soc_pcm_voice_usb";
	};

	mt_soc_pcm_voice_usb_echoref {
		compatible = "mediatek,mt_soc_pcm_voice_usb_echoref";
	};

	mt_soc_routing_dai_name {
		compatible = "mediatek,mt_soc_dai_routing";
	};

	mt_soc_routing_pcm {
		compatible = "mediatek,mt_soc_pcm_routing";
	};

	mt_soc_tdmrx_pcm {
		compatible = "mediatek,mt_soc_tdm_capture";
	};

	mt_soc_ul1_pcm {
		compatible = "mediatek,mt_soc_pcm_capture";
	};

	mt_soc_ul2_pcm {
		compatible = "mediatek,mt_soc_pcm_capture2";
	};

	mt_soc_uldlloopback_pcm {
		compatible = "mediatek,mt_soc_pcm_uldlloopback";
	};

	mt_soc_voice_md1 {
		compatible = "mediatek,mt_soc_pcm_voice_md1";
	};

	mt_soc_voice_md1_bt {
		compatible = "mediatek,mt_soc_pcm_voice_md1_bt";
	};

	mt_soc_voice_md2 {
		compatible = "mediatek,mt_soc_pcm_voice_md2";
	};

	mt_soc_voice_md2_bt {
		compatible = "mediatek,mt_soc_pcm_voice_md2_bt";
	};

	mt_soc_voip_bt_in {
		compatible = "mediatek,mt_soc_pcm_bt_dai";
	};

	mt_soc_voip_bt_out {
		compatible = "mediatek,mt_soc_pcm_dl1_bt";
	};

	mtkfb {
		compatible = "mediatek,mtkfb";
		linux,phandle = <0x53>;
		phandle = <0x53>;
	};

	nfc {
		compatible = "mediatek,nfc-gpio-v2";
		gpio-irq = <0x0e>;
		gpio-irq-std = <0x2e 0x0e 0x00>;
		gpio-rst = <0x07>;
		gpio-rst-std = <0x2e 0x07 0x00>;
		linux,phandle = <0x69>;
		phandle = <0x69>;
	};

	nfi@11018000 {
		clock-names = "nfi2x_sel\0nfiecc_sel\0clk26m\0syspll2_d2\0syspll_d7\0syspll_d3\0syspll2_d4\0msdcpll_d2\0univpll1_d2\0univpll_d5\0syspll4_d2\0univpll2_d4\0syspll1_d2\0univpll2_d2\0syspll_d5\0infra_nfiecc\0infra_nfi\0infra_nfi_1x";
		clocks = <0x24 0x3a 0x24 0x3b 0x25 0x24 0x07 0x24 0x0c 0x24 0x06 0x24 0x08 0x24 0x23 0x24 0x15 0x24 0x1c 0x24 0x0d 0x24 0x19 0x24 0x02 0x24 0x18 0x24 0x09 0x19 0x1e 0x19 0x27 0x19 0x4f>;
		compatible = "mediatek,nfi";
		interrupts = <0x00 0x86 0x08>;
		reg = <0x00 0x11018000 0x00 0x1000>;
	};

	nfiecc@11019000 {
		compatible = "mediatek,nfiecc";
		interrupts = <0x00 0x87 0x08>;
		reg = <0x00 0x11019000 0x00 0x1000>;
	};

	odm {
		compatible = "simple-bus";
		linux,phandle = <0x6e>;
		phandle = <0x6e>;
	};

	otg_iddig {
		compatible = "mediatek,usb_iddig_bi_eint";
		linux,phandle = <0x68>;
		phandle = <0x68>;
	};

	pericfg@10003000 {
		compatible = "mediatek,pericfg";
		reg = <0x00 0x10003000 0x00 0x1000>;
	};

	pinctrl@1000b000 {
		#gpio-cells = <0x02>;
		#interrupt-cells = <0x04>;
		compatible = "mediatek,pinctrl";
		gpio-controller;
		interrupt-controller;
		interrupts = <0x00 0xa7 0x04>;
		linux,phandle = <0x2e>;
		mediatek,pctl-regmap = <0x0e 0x0f 0x10 0x11 0x12 0x13 0x14 0x15>;
		phandle = <0x2e>;
		pins-are-numbered;
		reg = <0x00 0x1000b000 0x00 0x1000>;
	};

	pmic_clock_buffer_ctrl {
		compatible = "mediatek,pmic_clock_buffer";
		linux,phandle = <0x5b>;
		mediatek,clkbuf-config = <0x02 0x01 0x01 0x02 0x00 0x00 0x00>;
		mediatek,clkbuf-driving-current = <0xffffffff 0xffffffff 0xffffffff 0xffffffff 0xffffffff 0xffffffff 0xffffffff>;
		mediatek,clkbuf-quantity = <0x07>;
		phandle = <0x5b>;
	};

	pmu {
		compatible = "arm,cortex-a7-pmu";
		interrupt-parent = <0x02>;
		interrupts = <0x01 0x07 0x08>;
	};

	psci {
		compatible = "arm,psci-0.2";
		method = "smc";
	};

	pwm@11006000 {
		clock-names = "PWM1-main\0PWM2-main\0PWM3-main\0PWM4-main\0PWM5-main\0PWM6-main\0PWM-HCLK-main\0PWM-main";
		clocks = <0x19 0x0e 0x19 0x0f 0x19 0x10 0x19 0x11 0x19 0x12 0x19 0x32 0x19 0x0d 0x19 0x13>;
		compatible = "mediatek,pwm";
		interrupts = <0x00 0x4d 0x08>;
		reg = <0x00 0x11006000 0x00 0x1000>;
	};

	pwrap@1000d000 {
		compatible = "mediatek,pwrap";
		interrupts = <0x00 0xaf 0x04>;
		reg = <0x00 0x1000d000 0x00 0x1000>;

		pmic_irq {
			compatible = "mediatek,pmic-eint";
			interrupt-controller;
			linux,phandle = <0x3e>;
			phandle = <0x3e>;
		};
	};

	reserved-memory {
		#address-cells = <0x02>;
		#size-cells = <0x02>;
		linux,phandle = <0x3a>;
		phandle = <0x3a>;
		ranges;

		consys-reserve-memory {
			#address-cells = <0x02>;
			#size-cells = <0x02>;
			alignment = <0x00 0x200000>;
			alloc-ranges = <0x00 0x40000000 0x00 0x38000000>;
			compatible = "mediatek,consys-reserve-memory";
			no-map;
			size = <0x00 0x200000>;
		};

		minirdump-reserved-memory@444f0000 {
			compatible = "mediatek,minirdump";
			reg = <0x00 0x444f0000 0x00 0x10000>;
		};

		pstore-reserved-memory@44410000 {
			compatible = "mediatek,pstore";
			reg = <0x00 0x44410000 0x00 0xe0000>;
		};

		ram_console-reserved-memory@44400000 {
			compatible = "mediatek,ram_console";
			reg = <0x00 0x44400000 0x00 0x10000>;
		};

		soter-shared-mem {
			alloc-ranges = <0x00 0x40000000 0x00 0x50000000>;
			compatible = "microtrust,shared_mem";
			no-map;
			size = <0x00 0x200000>;
		};
	};

	rt9465_slave_chr {
		linux,phandle = <0x65>;
		phandle = <0x65>;
	};

	scpsys@10001000 {
		#clock-cells = <0x01>;
		compatible = "mediatek,scpsys";
		linux,phandle = <0x1a>;
		phandle = <0x1a>;
		reg = <0x00 0x10001000 0x00 0x1000 0x00 0x10006000 0x00 0x1000 0x00 0x1020e000 0x00 0x1000>;
	};

	security_ao@1001a000 {
		compatible = "mediatek,security_ao";
		reg = <0x00 0x1001a000 0x00 0x1000>;
	};

	seninf@15008000 {
		compatible = "mediatek,seninf";
		reg = <0x00 0x15008000 0x00 0x1000>;
	};

	sleep@10006000 {
		compatible = "mediatek,sleep";
		interrupts = <0x00 0xb1 0x08>;
		reg = <0x00 0x10006000 0x00 0x1000>;
		wakeup-source = <0x16 0x00 0x04 0x17 0x03 0x2000000>;
	};

	sleep_reg_md@1000f000 {
		compatible = "mediatek,sleep_reg_md";
		reg = <0x00 0x1000f000 0x00 0x1000>;
	};

	smi_common@14002000 {
		clock-names = "mtcmos-mm\0smi-common-gals0\0smi-common-gals1\0smi-common\0MMDVFS_CLK_TOP_MMPLL_CK\0mmdvfs_clk_top_vencpll_ck\0mmdvfs_clk_top_syspll2_d2";
		clocks = <0x1a 0x04 0x1b 0x02 0x1b 0x03 0x1b 0x00 0x24 0x2c 0x24 0x21 0x24 0x07>;
		compatible = "mediatek,smi_common";
		larbs = <0x33 0x34 0x35>;
		reg = <0x00 0x14002000 0x00 0x1000>;
	};

	smi_larb0@14003000 {
		clock-names = "mtcmos-mm\0mm-larb0";
		clocks = <0x1a 0x04 0x1b 0x01>;
		compatible = "mediatek,smi_larb0";
		interrupts = <0x00 0xdf 0x08>;
		linux,phandle = <0x33>;
		phandle = <0x33>;
		reg = <0x00 0x14003000 0x00 0x1000>;
	};

	smi_larb1@17010000 {
		clock-names = "mtcmos-ven\0venc-larb\0venc-venc";
		clocks = <0x1a 0x06 0x37 0x00 0x37 0x01>;
		compatible = "mediatek,smi_larb1";
		interrupts = <0x00 0xd5 0x08>;
		linux,phandle = <0x34>;
		phandle = <0x34>;
		reg = <0x00 0x17010000 0x00 0x1000>;
	};

	smi_larb2@15001000 {
		clock-names = "mtcmos-img\0img-larb2";
		clocks = <0x1a 0x05 0x36 0x00>;
		compatible = "mediatek,smi_larb2";
		interrupts = <0x00 0xde 0x08>;
		linux,phandle = <0x35>;
		phandle = <0x35>;
		reg = <0x00 0x15001000 0x00 0x1000>;
	};

	smi_larb3@17010000 {
		compatible = "mediatek,smi_larb3";
		interrupts = <0x00 0xe7 0x08>;
		reg = <0x00 0x17010000 0x00 0x1000>;
	};

	spi2@11010000 {
		compatible = "mediatek,spi2";
		interrupts = <0x00 0x80 0x08>;
		reg = <0x00 0x11010000 0x00 0x1000>;
	};

	spi3@11012000 {
		compatible = "mediatek,spi3";
		interrupts = <0x00 0x81 0x08>;
		reg = <0x00 0x11012000 0x00 0x00>;
	};

	spi4@11013000 {
		compatible = "mediatek,spi4";
		reg = <0x00 0x11013000 0x00 0x1000>;
	};

	spi@1100a000 {
		clock-names = "parent-clk\0sel-clk\0spi-clk";
		clocks = <0x24 0x0a 0x24 0x30 0x19 0x1b>;
		compatible = "mediatek,mt6739-spi";
		interrupts = <0x00 0x76 0x08>;
		linux,phandle = <0x48>;
		mediatek,pad-select = <0x00>;
		phandle = <0x48>;
		reg = <0x00 0x1100a000 0x00 0x1000>;
	};

	spi@11010000 {
		clock-names = "parent-clk\0sel-clk\0spi-clk";
		clocks = <0x24 0x0a 0x24 0x30 0x19 0x36>;
		compatible = "mediatek,mt6739-spi";
		interrupts = <0x00 0x7a 0x08>;
		linux,phandle = <0x49>;
		mediatek,pad-select = <0x00>;
		phandle = <0x49>;
		reg = <0x00 0x11010000 0x00 0x1000>;
	};

	spi@11012000 {
		clock-names = "parent-clk\0sel-clk\0spi-clk";
		clocks = <0x24 0x0a 0x24 0x30 0x19 0x39>;
		compatible = "mediatek,mt6739-spi";
		interrupts = <0x00 0x80 0x08>;
		linux,phandle = <0x4a>;
		mediatek,pad-select = <0x00>;
		phandle = <0x4a>;
		reg = <0x00 0x11012000 0x00 0x1000>;
	};

	sramrom@10214000 {
		compatible = "mediatek,sramrom";
		reg = <0x00 0x10214000 0x00 0x1000>;
	};

	sys_cirq@10204000 {
		compatible = "mediatek,sys_cirq";
		interrupts = <0x00 0xf0 0x08>;
		mediatek,cirq_num = <0xa8>;
		mediatek,spi_start_offset = <0x48>;
		reg = <0x00 0x10204000 0x00 0x1000>;
	};

	sys_timer@10017000 {
		compatible = "mediatek,sys_timer";
		interrupts = <0x00 0xba 0x04>;
		mediatek,sysram-size = <0x14>;
		reg = <0x00 0x10017000 0x00 0x1000 0x00 0x10218da0 0x00 0x14>;
		reg-names = "sys_timer_base\0sysram_base";
	};

	syscfg_pctl_a@10005000 {
		compatible = "mediatek,pctl-a-syscfg\0syscon";
		linux,phandle = <0x0e>;
		phandle = <0x0e>;
		reg = <0x00 0x10005000 0x00 0x1000>;
	};

	syscfg_pctl_bl@10002600 {
		compatible = "mediatek,pctl-bl-syscfg\0syscon";
		linux,phandle = <0x12>;
		phandle = <0x12>;
		reg = <0x00 0x10002600 0x00 0x1000>;
	};

	syscfg_pctl_bl@10002c00 {
		compatible = "mediatek,pctl-rt-syscfg\0syscon";
		linux,phandle = <0x15>;
		phandle = <0x15>;
		reg = <0x00 0x10002c00 0x00 0x1000>;
	};

	syscfg_pctl_bm@10002800 {
		compatible = "mediatek,pctl-bm-syscfg\0syscon";
		linux,phandle = <0x13>;
		phandle = <0x13>;
		reg = <0x00 0x10002800 0x00 0x1000>;
	};

	syscfg_pctl_lb@10002400 {
		compatible = "mediatek,pctl-lb-syscfg\0syscon";
		linux,phandle = <0x11>;
		phandle = <0x11>;
		reg = <0x00 0x10002400 0x00 0x1000>;
	};

	syscfg_pctl_lm@10002200 {
		compatible = "mediatek,pctl-lm-syscfg\0syscon";
		linux,phandle = <0x10>;
		phandle = <0x10>;
		reg = <0x00 0x10002200 0x00 0x1000>;
	};

	syscfg_pctl_lt@10002000 {
		compatible = "mediatek,pctl-lt-syscfg\0syscon";
		linux,phandle = <0x0f>;
		phandle = <0x0f>;
		reg = <0x00 0x10002000 0x00 0x1000>;
	};

	syscfg_pctl_rb@10002a00 {
		compatible = "mediatek,pctl-rb-syscfg\0syscon";
		linux,phandle = <0x14>;
		phandle = <0x14>;
		reg = <0x00 0x10002a00 0x00 0x1000>;
	};

	therm_ctrl@1100b000 {
		clock-names = "therm-main";
		clocks = <0x19 0x08>;
		compatible = "mediatek,therm_ctrl";
		interrupts = <0x00 0x4e 0x08>;
		reg = <0x00 0x1100b000 0x00 0x1000>;
	};

	timer {
		clock-frequency = <0xc65d40>;
		compatible = "arm,armv8-timer";
		interrupt-parent = <0x02>;
		interrupts = <0x01 0x0d 0x08 0x01 0x0e 0x08 0x01 0x0b 0x08 0x01 0x0a 0x08>;
	};

	tkcore {
		compatible = "trustkernel,tkcore";
		interrupts = <0x00 0x6f 0x01>;
	};

	topckgen@10000000 {
		#clock-cells = <0x01>;
		compatible = "mediatek,topckgen\0syscon";
		linux,phandle = <0x24>;
		phandle = <0x24>;
		reg = <0x00 0x10000000 0x00 0x1000 0x00 0x1000c000 0x00 0x1000>;
	};

	topckgen_ao@1001b000 {
		compatible = "mediatek,topckgen_ao";
		reg = <0x00 0x1001b000 0x00 0x1000>;
	};

	topmisc@10011000 {
		compatible = "mediatek,topmisc";
		reg = <0x00 0x10011000 0x00 0x1000>;
	};

	toprgu@10007000 {
		compatible = "mediatek,toprgu";
		interrupts = <0x00 0x8b 0x00>;
		reg = <0x00 0x10007000 0x00 0x1000>;
	};

	touch {
		compatible = "mediatek,mt6739-touch";
		linux,phandle = <0x4e>;
		phandle = <0x4e>;
	};

	trng@1020f000 {
		compatible = "mediatek,trng";
		interrupts = <0x00 0xa1 0x08>;
		reg = <0x00 0x1020f000 0x00 0x1000>;
	};

	trusty {
		#address-cells = <0x02>;
		#size-cells = <0x02>;
		compatible = "android,trusty-smc-v1";
		ranges;

		irq {
			compatible = "android,trusty-irq-v1";
			ppi-interrupt-parent = <0x02>;
		};

		log {
			compatible = "android,trusty-log-v1";
		};

		mtee {
			compatible = "mediatek,trusty-mtee-v1";
		};

		virtio {
			compatible = "android,trusty-virtio-v1";
		};
	};

	usb0@11200000 {
		clock-names = "usb0\0usb0_clk_top_sel\0usb0_clk_univpll3_d4";
		clocks = <0x19 0x06 0x24 0x3c 0x24 0x1e>;
		compatible = "mediatek,mt6739-usb20";
		interrupts = <0x00 0x49 0x08>;
		mode = <0x02>;
		multipoint = <0x01>;
		num_eps = <0x10>;
		reg = <0x00 0x11200000 0x00 0x10000 0x00 0x11cc0000 0x00 0x10000>;
	};

	utos {
		compatible = "microtrust,utos";
		interrupts = <0x00 0x83 0x01 0x00 0x84 0x01>;
	};

	utos_tester {
		compatible = "microtrust,tester-v1";
	};

	vdec@17040000 {
		compatible = "mediatek,vdec";
		interrupts = <0x00 0xd7 0x08>;
		reg = <0x00 0x17040000 0x00 0x10000>;
	};

	vdec_gcon@17000000 {
		clock-names = "MT_CG_VDEC\0MT_CG_VENC\0MT_SCP_SYS_VDE\0MT_SCP_SYS_VEN";
		clocks = <0x37 0x03 0x37 0x01 0x1a 0x06 0x1a 0x06>;
		compatible = "mediatek,vdec_gcon";
		reg = <0x00 0x17000000 0x00 0x1000>;
	};

	venc@17020000 {
		compatible = "mediatek,venc";
		interrupts = <0x00 0xd4 0x08>;
		linux,phandle = <0x57>;
		phandle = <0x57>;
		reg = <0x00 0x17020000 0x00 0x1000>;
	};

	venc_global_con@17000000 {
		#clock-cells = <0x01>;
		compatible = "mediatek,venc_global_con\0syscon";
		linux,phandle = <0x37>;
		phandle = <0x37>;
		reg = <0x00 0x17000000 0x00 0x10000>;
	};

	venc_jpg@17030000 {
		clock-names = "MT_CG_VENC_JPGENC";
		clocks = <0x37 0x02>;
		compatible = "mediatek,venc_jpg";
		interrupts = <0x00 0xd6 0x08>;
		reg = <0x00 0x17030000 0x00 0x1000>;
	};

	wifi@180f0000 {
		clock-names = "wifi-dma";
		clocks = <0x19 0x28>;
		compatible = "mediatek,wifi";
		dma_addrmask = <0x24>;
		interrupts = <0x00 0xea 0x08>;
		reg = <0x00 0x180f0000 0x00 0x5c>;
	};
};
