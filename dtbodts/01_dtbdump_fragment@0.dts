/dts-v1/;

/ {

	__fixups__ {
		accdet = "/fragment@9:target:0";
		apuart0 = "/fragment@15:target:0";
		audgpio = "/fragment@27:target:0";
		auxadc = "/fragment@29:target:0";
		chosen = "/fragment@0:target:0";
		consys = "/fragment@11:target:0";
		dsi_te = "/fragment@40:target:0";
		flashlights_aw3644 = "/fragment@23:target:0";
		flashlights_dio5644 = "/fragment@25:target:0";
		gpio_usage_mapping = "/fragment@37:target:0";
		i2c0 = "/fragment@19:target:0\0/fragment@31:target:0";
		i2c1 = "/fragment@2:target:0\0/fragment@32:target:0";
		i2c2 = "/fragment@12:target:0\0/fragment@26:target:0\0/fragment@33:target:0";
		i2c3 = "/fragment@34:target:0";
		i2c4 = "/fragment@35:target:0";
		i2c5 = "/fragment@36:target:0";
		irtx_pwm = "/fragment@13:target:0";
		kd_camera_hw1 = "/fragment@21:target:0\0/fragment@50:target:0";
		keypad = "/fragment@52:target:0";
		main_pmic = "/fragment@41:target:0";
		md1_sim1_hot_plug_eint = "/fragment@42:target:0";
		md1_sim2_hot_plug_eint = "/fragment@43:target:0";
		msdc1_ins = "/fragment@39:target:0";
		mt_pmic_vcama_ldo_reg = "/fragment@44:target:0\0/fragment@50/__overlay__:vcama-supply:0\0/fragment@50/__overlay__:vcama_sub-supply:0";
		mt_pmic_vcamd_ldo_reg = "/fragment@47:target:0\0/fragment@50/__overlay__:vcamd-supply:0\0/fragment@50/__overlay__:vcamd_sub-supply:0";
		mt_pmic_vcamio_ldo_reg = "/fragment@48:target:0\0/fragment@50/__overlay__:vcamio-supply:0\0/fragment@50/__overlay__:vcamio_sub-supply:0";
		mt_pmic_vldo28_ldo_reg = "/fragment@49:target:0\0/fragment@50/__overlay__:vcamaf-supply:0\0/fragment@51/__overlay__:vtouch-supply:0";
		mt_pmic_vsim1_ldo_reg = "/fragment@45:target:0";
		mt_pmic_vsim2_ldo_reg = "/fragment@46:target:0";
		mtkfb = "/fragment@8:target:0";
		odm = "/fragment@1:target:0";
		pio = "/fragment@1/__overlay__/fingerprint:interrupt-parent:0\0/fragment@2/__overlay__/alsps_ltr559@23:interrupt-parent:0\0/fragment@3:target:0\0/fragment@4:target:0\0/fragment@6:target:0\0/fragment@7:target:0\0/fragment@10:target:0\0/fragment@14:target:0\0/fragment@16:target:0\0/fragment@18:target:0\0/fragment@20:target:0\0/fragment@22:target:0\0/fragment@24:target:0\0/fragment@27/__overlay__:extamp_gpio:0\0/fragment@28:target:0\0/fragment@37/__overlay__:GPIO_SIM1_HOT_PLUG:0\0/fragment@37/__overlay__:GPIO_SIM2_HOT_PLUG:0\0/fragment@37/__overlay__:GPIO_SIM1_SCLK:0\0/fragment@37/__overlay__:GPIO_SIM1_SRST:0\0/fragment@37/__overlay__:GPIO_SIM1_SIO:0\0/fragment@37/__overlay__:GPIO_SIM2_SCLK:0\0/fragment@37/__overlay__:GPIO_SIM2_SRST:0\0/fragment@37/__overlay__:GPIO_SIM2_SIO:0\0/fragment@37/__overlay__:GPIO_FDD_BAND_SUPPORT_DETECT_1ST_PIN:0\0/fragment@37/__overlay__:GPIO_FDD_BAND_SUPPORT_DETECT_2ND_PIN:0\0/fragment@37/__overlay__:GPIO_FDD_BAND_SUPPORT_DETECT_3RD_PIN:0\0/fragment@38/__overlay__:interrupt-parent:0\0/fragment@39/__overlay__:interrupt-parent:0\0/fragment@39/__overlay__:deb-gpios:0\0/fragment@40/__overlay__:interrupt-parent:0\0/fragment@41/__overlay__:interrupt-parent:0";
		pmic_clock_buffer_ctrl = "/fragment@30:target:0";
		spi0 = "/fragment@5:target:0";
		touch = "/fragment@17:target:0\0/fragment@38:target:0\0/fragment@51:target:0";
	};

	__local_fixups__ {

		fragment@1 {

			__overlay__ {

				fingerprint {
					pinctrl-0 = <0x00>;
					pinctrl-1 = <0x00>;
					pinctrl-2 = <0x00>;
					pinctrl-3 = <0x00>;
					pinctrl-4 = <0x00>;
				};
			};
		};

		fragment@11 {

			__overlay__ {
				pinctrl-0 = <0x00>;
				pinctrl-1 = <0x00>;
				pinctrl-2 = <0x00>;
				pinctrl-3 = <0x00>;
			};
		};

		fragment@13 {

			__overlay__ {
				pinctrl-0 = <0x00>;
				pinctrl-1 = <0x00>;
			};
		};

		fragment@15 {

			__overlay__ {
				pinctrl-0 = <0x00>;
				pinctrl-1 = <0x00>;
				pinctrl-2 = <0x00>;
				pinctrl-3 = <0x00>;
				pinctrl-4 = <0x00>;
			};
		};

		fragment@17 {

			__overlay__ {
				pinctrl-0 = <0x00>;
				pinctrl-1 = <0x00>;
				pinctrl-2 = <0x00>;
				pinctrl-3 = <0x00>;
				pinctrl-4 = <0x00>;
				pinctrl-5 = <0x00>;
			};
		};

		fragment@2 {

			__overlay__ {

				alsps_ltr559@23 {
					pinctrl-0 = <0x00>;
					pinctrl-1 = <0x00>;
				};
			};
		};

		fragment@21 {

			__overlay__ {
				pinctrl-0 = <0x00>;
				pinctrl-1 = <0x00>;
				pinctrl-10 = <0x00>;
				pinctrl-11 = <0x00>;
				pinctrl-12 = <0x00>;
				pinctrl-2 = <0x00>;
				pinctrl-3 = <0x00>;
				pinctrl-4 = <0x00>;
				pinctrl-5 = <0x00>;
				pinctrl-6 = <0x00>;
				pinctrl-7 = <0x00>;
				pinctrl-8 = <0x00>;
				pinctrl-9 = <0x00>;
			};
		};

		fragment@23 {

			__overlay__ {
				pinctrl-0 = <0x00>;
				pinctrl-1 = <0x00>;
				pinctrl-2 = <0x00>;
			};
		};

		fragment@25 {

			__overlay__ {
				pinctrl-0 = <0x00>;
				pinctrl-1 = <0x00>;
				pinctrl-2 = <0x00>;
			};
		};

		fragment@27 {

			__overlay__ {
				pinctrl-0 = <0x00>;
				pinctrl-1 = <0x00>;
				pinctrl-2 = <0x00>;
				pinctrl-3 = <0x00>;
				pinctrl-4 = <0x00>;
				pinctrl-5 = <0x00>;
			};
		};

		fragment@8 {

			__overlay__ {
				pinctrl-0 = <0x00>;
				pinctrl-1 = <0x00>;
				pinctrl-2 = <0x00>;
				pinctrl-3 = <0x00>;
				pinctrl-4 = <0x00>;
				pinctrl-5 = <0x00>;
				pinctrl-6 = <0x00>;
				pinctrl-7 = <0x00>;
			};
		};
	};

	__symbols__ {
		alsps_intpin_cfg = "/fragment@4/__overlay__/alspspincfg";
		alsps_intpin_default = "/fragment@4/__overlay__/alspsdefaultcfg";
		alsps_mtk = "/fragment@2/__overlay__/alsps_ltr559@23";
		aud_dat_miso_off = "/fragment@28/__overlay__/aud_dat_miso_off";
		aud_dat_miso_on = "/fragment@28/__overlay__/aud_dat_miso_on";
		aud_dat_mosi_off = "/fragment@28/__overlay__/aud_dat_mosi_off";
		aud_dat_mosi_on = "/fragment@28/__overlay__/aud_dat_mosi_on";
		aud_pins_extamp_high = "/fragment@28/__overlay__/audexamphigh";
		aud_pins_extamp_low = "/fragment@28/__overlay__/audexamplow";
		camera_main_af_mtk = "/fragment@33/__overlay__/camera_main_af@0c";
		camera_main_mtk = "/fragment@33/__overlay__/camera_main@10";
		camera_pins_cam0_mclk_off = "/fragment@20/__overlay__/camera_pins_cam0_mclk_off";
		camera_pins_cam0_mclk_on = "/fragment@20/__overlay__/camera_pins_cam0_mclk_on";
		camera_pins_cam0_pdn0 = "/fragment@20/__overlay__/cam0@2";
		camera_pins_cam0_pdn1 = "/fragment@20/__overlay__/cam0@3";
		camera_pins_cam0_rst0 = "/fragment@20/__overlay__/cam0@0";
		camera_pins_cam0_rst1 = "/fragment@20/__overlay__/cam0@1";
		camera_pins_cam1_mclk_off = "/fragment@20/__overlay__/camera_pins_cam1_mclk_off";
		camera_pins_cam1_mclk_on = "/fragment@20/__overlay__/camera_pins_cam1_mclk_on";
		camera_pins_cam1_pdn0 = "/fragment@20/__overlay__/cam1@02";
		camera_pins_cam1_pdn1 = "/fragment@20/__overlay__/cam1@3";
		camera_pins_cam1_rst0 = "/fragment@20/__overlay__/cam1@0";
		camera_pins_cam1_rst1 = "/fragment@20/__overlay__/cam1@1";
		camera_pins_default = "/fragment@20/__overlay__/camdefault";
		camera_sub_mtk = "/fragment@33/__overlay__/camera_sub@37";
		cap_touch_mtk = "/fragment@31/__overlay__/cap_touch@38";
		consys_pins_default = "/fragment@10/__overlay__/consys_default";
		ctp_pins_default = "/fragment@18/__overlay__/eint0default";
		ctp_pins_eint_as_int = "/fragment@18/__overlay__/eint@0";
		ctp_pins_eint_output0 = "/fragment@18/__overlay__/eintoutput0";
		ctp_pins_eint_output1 = "/fragment@18/__overlay__/eintoutput1";
		ctp_pins_rst_output0 = "/fragment@18/__overlay__/rstoutput0";
		ctp_pins_rst_output1 = "/fragment@18/__overlay__/rstoutput1";
		fingerprint = "/fragment@1/__overlay__/fingerprint";
		fingerprint_default = "/fragment@6/__overlay__/fingerprint_default";
		fingerprint_eint = "/fragment@6/__overlay__/gpio8_eint";
		fingerprint_eint_pull_down = "/fragment@6/__overlay__/gpio8_eint_pull_down";
		fingerprint_rst_one = "/fragment@6/__overlay__/rst_out_one";
		fingerprint_rst_zero = "/fragment@6/__overlay__/rst_out_zero";
		flashlights_aw3644_pins_default = "/fragment@22/__overlay__/aw3644default";
		flashlights_aw3644_pins_hwen_high = "/fragment@22/__overlay__/hwen_high";
		flashlights_aw3644_pins_hwen_low = "/fragment@22/__overlay__/hwen_low";
		flashlights_dio5644_pins_default = "/fragment@24/__overlay__/dio5644default";
		flashlights_dio5644_pins_hwen_high = "/fragment@24/__overlay__/hwen_high";
		flashlights_dio5644_pins_hwen_low = "/fragment@24/__overlay__/hwen_low";
		gpslna_pins_init = "/fragment@10/__overlay__/gpslna@0";
		gpslna_pins_oh = "/fragment@10/__overlay__/gpslna@1";
		gpslna_pins_ol = "/fragment@10/__overlay__/gpslna@2";
		gyro_intpin_cfg = "/fragment@3/__overlay__/gyropincfg";
		gyro_intpin_default = "/fragment@3/__overlay__/gyrodefaultcfg";
		i2c_lcd_bias_mtk = "/fragment@34/__overlay__/i2c_lcd_bias@3e";
		irtx_gpio_led_default = "/fragment@14/__overlay__/irtx_gpio_led_def@gpio12";
		irtx_gpio_led_set = "/fragment@14/__overlay__/irtx_gpio_led_set@gpio12";
		led0 = "/fragment@1/__overlay__/led@0";
		led1 = "/fragment@1/__overlay__/led@1";
		led2 = "/fragment@1/__overlay__/led@2";
		led3 = "/fragment@1/__overlay__/led@3";
		led4 = "/fragment@1/__overlay__/led@4";
		led5 = "/fragment@1/__overlay__/led@5";
		led6 = "/fragment@1/__overlay__/led@6";
		mtkfb_pins_lcd_bias_enn0 = "/fragment@7/__overlay__/lcd_bias_enn0_gpio";
		mtkfb_pins_lcd_bias_enn1 = "/fragment@7/__overlay__/lcd_bias_enn1_gpio";
		mtkfb_pins_lcd_bias_enp0 = "/fragment@7/__overlay__/lcd_bias_enp0_gpio";
		mtkfb_pins_lcd_bias_enp1 = "/fragment@7/__overlay__/lcd_bias_enp1_gpio";
		mtkfb_pins_lcm_reset0 = "/fragment@7/__overlay__/lcm_rst_out0_gpio";
		mtkfb_pins_lcm_reset1 = "/fragment@7/__overlay__/lcm_rst_out1_gpio";
		mtkfb_pins_mode_te_gpio = "/fragment@7/__overlay__/mode_te_gpio";
		mtkfb_pins_mode_te_te = "/fragment@7/__overlay__/mode_te_te";
		nfc_mtk = "/fragment@34/__overlay__/nfc@08";
		strobe_main_mtk = "/fragment@34/__overlay__/strobe_main@63";
		sw_charger_mtk = "/fragment@32/__overlay__/sw_charger@6a";
		uart0_gpio_def_cfg = "/fragment@16/__overlay__/uart0gpiodefault";
		uart0_rx_clr_cfg = "/fragment@16/__overlay__/uart0_rx_clear@gpio20";
		uart0_rx_set_cfg = "/fragment@16/__overlay__/uart0_rx_set@gpio20";
		uart0_tx_clr_cfg = "/fragment@16/__overlay__/uart0_tx_clear@gpio21";
		uart0_tx_set_cfg = "/fragment@16/__overlay__/uart0_tx_set@gpio21";
		vibrator0 = "/fragment@1/__overlay__/vibrator@0";
	};

	fragment@0 {
		target = <0xffffffff>;

		__overlay__ {
			atag,videolfb-fb_base_h = <0x00>;
			atag,videolfb-fb_base_l = "^`P";
			atag,videolfb-fps = <0x1770>;
			atag,videolfb-islcm_inited = <0x00>;
			atag,videolfb-islcmfound = <0x01>;
			atag,videolfb-lcmname = "nt35521_hd_dsi_vdo_truly_nt50358_drv";
			atag,videolfb-vramSize = <0x17bb000>;
		};
	};

	fragment@1 {
		target = <0xffffffff>;

		__overlay__ {

			fingerprint {
				compatible = "mediatek,mt6753-fingerprint";
				interrupt-parent = <0xffffffff>;
				interrupts = <0x08 0x02 0x08 0x00>;
				linux,phandle = <0x42>;
				phandle = <0x42>;
				pinctrl-0 = <0x01>;
				pinctrl-1 = <0x02>;
				pinctrl-2 = <0x03>;
				pinctrl-3 = <0x04>;
				pinctrl-4 = <0x05>;
				pinctrl-names = "fingerprint_default\0fingerprint_pin_irq\0fingerprint_eint_pull_down\0fingerprint_reset_high\0fingerprint_reset_low\0fingerprint_power_high\0fingerprint_power_low";
				status = "okay";
			};

			led@0 {
				compatible = "mediatek,red";
				data = <0x01>;
				led_mode = <0x00>;
				linux,phandle = <0x3a>;
				phandle = <0x3a>;
				pwm_config = <0x00 0x00 0x00 0x00 0x00>;
			};

			led@1 {
				compatible = "mediatek,green";
				data = <0x01>;
				led_mode = <0x00>;
				linux,phandle = <0x3b>;
				phandle = <0x3b>;
				pwm_config = <0x00 0x00 0x00 0x00 0x00>;
			};

			led@2 {
				compatible = "mediatek,blue";
				data = <0x01>;
				led_mode = <0x00>;
				linux,phandle = <0x3c>;
				phandle = <0x3c>;
				pwm_config = <0x00 0x00 0x00 0x00 0x00>;
			};

			led@3 {
				compatible = "mediatek,jogball-backlight";
				data = <0x01>;
				led_mode = <0x00>;
				linux,phandle = <0x3d>;
				phandle = <0x3d>;
				pwm_config = <0x00 0x00 0x00 0x00 0x00>;
			};

			led@4 {
				compatible = "mediatek,keyboard-backlight";
				data = <0x01>;
				led_mode = <0x00>;
				linux,phandle = <0x3e>;
				phandle = <0x3e>;
				pwm_config = <0x00 0x00 0x00 0x00 0x00>;
			};

			led@5 {
				compatible = "mediatek,button-backlight";
				data = <0x01>;
				led_mode = <0x00>;
				linux,phandle = <0x3f>;
				phandle = <0x3f>;
				pwm_config = <0x00 0x00 0x00 0x00 0x00>;
			};

			led@6 {
				compatible = "mediatek,lcd-backlight";
				data = <0x01>;
				led_mode = <0x05>;
				linux,phandle = <0x40>;
				phandle = <0x40>;
				pwm_config = <0x00 0x02 0x00 0x00 0x00>;
			};

			vibrator@0 {
				compatible = "mediatek,vibrator";
				linux,phandle = <0x41>;
				phandle = <0x41>;
				vib_limit = <0x09>;
				vib_timer = <0x19>;
				vib_vol = <0x0b>;
			};
		};
	};

	fragment@10 {
		target = <0xffffffff>;

		__overlay__ {

			consys_default {
				linux,phandle = <0x10>;
				phandle = <0x10>;
			};

			gpslna@0 {
				linux,phandle = <0x11>;
				phandle = <0x11>;

				pins_cmd_dat {
					bias-disable;
					output-low;
					pins = <0x1a00>;
					slew-rate = <0x00>;
				};
			};

			gpslna@1 {
				linux,phandle = <0x12>;
				phandle = <0x12>;

				pins_cmd_dat {
					output-high;
					pins = <0x1a00>;
					slew-rate = <0x01>;
				};
			};

			gpslna@2 {
				linux,phandle = <0x13>;
				phandle = <0x13>;

				pins_cmd_dat {
					output-low;
					pins = <0x1a00>;
					slew-rate = <0x01>;
				};
			};
		};
	};

	fragment@11 {
		target = <0xffffffff>;

		__overlay__ {
			pinctrl-0 = <0x10>;
			pinctrl-1 = <0x11>;
			pinctrl-2 = <0x12>;
			pinctrl-3 = <0x13>;
			pinctrl-names = "default\0gps_lna_state_init\0gps_lna_state_oh\0gps_lna_state_ol";
			status = "okay";
		};
	};

	fragment@12 {
		target = <0xffffffff>;

		__overlay__ {
			#address-cells = <0x01>;
			#size-cells = <0x00>;
			clock-frequency = <0x61a80>;

			mtk-usb@60 {
				compatible = "mediatek,mtk-usb";
				reg = <0x60>;
				status = "okay";
			};
		};
	};

	fragment@13 {
		target = <0xffffffff>;

		__overlay__ {
			pinctrl-0 = <0x14>;
			pinctrl-1 = <0x15>;
			pinctrl-names = "irtx_gpio_led_default\0irtx_gpio_led_set";
			status = "okay";
		};
	};

	fragment@14 {
		target = <0xffffffff>;

		__overlay__ {

			irtx_gpio_led_def@gpio12 {
				linux,phandle = <0x14>;
				phandle = <0x14>;

				pins_cmd_dat {
					bias-disable;
					input-schmitt-enable = <0x00>;
					output-low;
					pins = <0xc00>;
					slew-rate = <0x01>;
				};
			};

			irtx_gpio_led_set@gpio12 {
				linux,phandle = <0x15>;
				phandle = <0x15>;

				pins_cmd_dat {
					output-high;
					pins = <0xc05>;
					slew-rate = <0x01>;
				};
			};
		};
	};

	fragment@15 {
		target = <0xffffffff>;

		__overlay__ {
			pinctrl-0 = <0x16>;
			pinctrl-1 = <0x17>;
			pinctrl-2 = <0x18>;
			pinctrl-3 = <0x19>;
			pinctrl-4 = <0x1a>;
			pinctrl-names = "uart0_gpio_default\0uart0_rx_set\0uart0_rx_clear\0uart0_tx_set\0uart0_tx_clear";
			status = "okay";
		};
	};

	fragment@16 {
		target = <0xffffffff>;

		__overlay__ {

			uart0_rx_clear@gpio20 {
				linux,phandle = <0x18>;
				phandle = <0x18>;

				pins_cmd_dat {
					output-high;
					pins = <0x1400>;
					slew-rate = <0x01>;
				};
			};

			uart0_rx_set@gpio20 {
				linux,phandle = <0x17>;
				phandle = <0x17>;

				pins_cmd_dat {
					pins = <0x1401>;
				};
			};

			uart0_tx_clear@gpio21 {
				linux,phandle = <0x1a>;
				phandle = <0x1a>;

				pins_cmd_dat {
					output-high;
					pins = <0x1500>;
					slew-rate = <0x01>;
				};
			};

			uart0_tx_set@gpio21 {
				linux,phandle = <0x19>;
				phandle = <0x19>;

				pins_cmd_dat {
					pins = <0x1501>;
				};
			};

			uart0gpiodefault {
				linux,phandle = <0x16>;
				phandle = <0x16>;
			};
		};
	};

	fragment@17 {
		target = <0xffffffff>;

		__overlay__ {
			pinctrl-0 = <0x1b>;
			pinctrl-1 = <0x1c>;
			pinctrl-2 = <0x1d>;
			pinctrl-3 = <0x1e>;
			pinctrl-4 = <0x1f>;
			pinctrl-5 = <0x20>;
			pinctrl-names = "default\0state_eint_as_int\0state_eint_output0\0state_eint_output1\0state_rst_output0\0state_rst_output1";
			status = "okay";
			tpd-filter-custom-prameters = <0x00 0x00 0x00 0x00 0x00 0x00 0x00 0x00 0x00 0x00 0x00 0x00>;
			tpd-filter-custom-speed = <0x00 0x00 0x00>;
			tpd-filter-pixel-density = <0x6a>;
			tpd-key-dim-local = <0x5a 0x373 0x64 0x28 0xe6 0x373 0x64 0x28 0x172 0x373 0x64 0x28 0x00 0x00 0x00 0x00>;
			tpd-key-local = <0x8b 0xac 0x9e 0x00>;
			tpd-key-num = <0x03>;
			tpd-max-touch-num = <0x05>;
			tpd-resolution = <0x2d0 0x5a0>;
			use-tpd-button = <0x01>;
		};
	};

	fragment@18 {
		target = <0xffffffff>;

		__overlay__ {

			eint0default {
				linux,phandle = <0x1b>;
				phandle = <0x1b>;
			};

			eint@0 {
				linux,phandle = <0x1c>;
				phandle = <0x1c>;

				pins_cmd_dat {
					bias-disable;
					pins = <0x100>;
					slew-rate = <0x00>;
				};
			};

			eintoutput0 {
				linux,phandle = <0x1d>;
				phandle = <0x1d>;

				pins_cmd_dat {
					output-low;
					pins = <0x100>;
					slew-rate = <0x01>;
				};
			};

			eintoutput1 {
				linux,phandle = <0x1e>;
				phandle = <0x1e>;

				pins_cmd_dat {
					output-high;
					pins = <0x100>;
					slew-rate = <0x01>;
				};
			};

			rstoutput0 {
				linux,phandle = <0x1f>;
				phandle = <0x1f>;

				pins_cmd_dat {
					output-low;
					pins = <0x00>;
					slew-rate = <0x01>;
				};
			};

			rstoutput1 {
				linux,phandle = <0x20>;
				phandle = <0x20>;

				pins_cmd_dat {
					output-high;
					pins = <0x00>;
					slew-rate = <0x01>;
				};
			};
		};
	};

	fragment@19 {
		target = <0xffffffff>;

		__overlay__ {

			cap_touch@5d {
				compatible = "mediatek,cap_touch_2";
				reg = <0x5d>;
			};
		};
	};

	fragment@2 {
		target = <0xffffffff>;

		__overlay__ {

			alsps_ltr559@23 {
				als_level = <0x78 0xd2 0x14a 0x230 0x352 0x41a 0x27d8 0x3a98 0x3a98 0x4e20 0x4e20 0x4e20 0x4e20 0x4e20 0x4e20>;
				als_setting = <0x00 0x00 0x3c 0x4b 0x63 0x0a 0x0a 0x0a>;
				als_value = <0x64 0xc8 0x12c 0x1f4 0x320 0x3e8 0x7d0 0x1388 0x1f40 0x1f40 0x2800 0x2800 0x2800 0x2800 0x2800>;
				compatible = "mediatek,alsps_ltr559";
				i2c_addr = <0x23 0x00 0x00 0x00>;
				i2c_num = <0x01>;
				interrupt-parent = <0xffffffff>;
				interrupts = <0x05 0x08 0x05 0x00>;
				is_batch_supported_als = <0x00>;
				is_batch_supported_ps = <0x00>;
				linux,phandle = <0x43>;
				phandle = <0x43>;
				pinctrl-0 = <0x06>;
				pinctrl-1 = <0x07>;
				pinctrl-names = "pin_default\0pin_cfg";
				polling_mode_als = <0x01>;
				polling_mode_ps = <0x00>;
				power_id = <0xffff>;
				power_vol = <0x00>;
				ps_dynamic_cali = <0x6e 0x78 0x82 0x8c 0x96 0xa0 0xaa 0x640 0x28 0x32 0x3c 0x46 0x50 0x5a 0x64 0x60e>;
				ps_setting = <0x00 0x7f 0x04 0x00 0x64 0x10>;
				ps_threshold_high = <0xfa>;
				ps_threshold_low = <0x96>;
				reg = <0x23>;
				status = "okay";
			};

			gsensor_mxc400x@15 {
				compatible = "mediatek,gsensor_mxc400x";
				direction = <0x04>;
				firlen = <0x10>;
				i2c_addr = <0x15 0x00 0x00 0x00>;
				i2c_num = <0x01>;
				is_batch_supported = <0x00>;
				power_id = <0xffff>;
				power_vol = <0x00>;
				reg = <0x15>;
				status = "okay";
			};
		};
	};

	fragment@20 {
		target = <0xffffffff>;

		__overlay__ {

			cam0@0 {
				linux,phandle = <0x22>;
				phandle = <0x22>;

				pins_cmd_dat {
					output-low;
					pins = <0x1800>;
					slew-rate = <0x01>;
				};
			};

			cam0@1 {
				linux,phandle = <0x23>;
				phandle = <0x23>;

				pins_cmd_dat {
					output-high;
					pins = <0x1800>;
					slew-rate = <0x01>;
				};
			};

			cam0@2 {
				linux,phandle = <0x24>;
				phandle = <0x24>;

				pins_cmd_dat {
					output-low;
					pins = <0x1700>;
					slew-rate = <0x01>;
				};
			};

			cam0@3 {
				linux,phandle = <0x25>;
				phandle = <0x25>;

				pins_cmd_dat {
					output-high;
					pins = <0x1700>;
					slew-rate = <0x01>;
				};
			};

			cam1@0 {
				linux,phandle = <0x26>;
				phandle = <0x26>;

				pins_cmd_dat {
					output-low;
					pins = <0x1e00>;
					slew-rate = <0x01>;
				};
			};

			cam1@02 {
				linux,phandle = <0x28>;
				phandle = <0x28>;

				pins_cmd_dat {
					output-low;
					pins = <0x1600>;
					slew-rate = <0x01>;
				};
			};

			cam1@1 {
				linux,phandle = <0x27>;
				phandle = <0x27>;

				pins_cmd_dat {
					output-high;
					pins = <0x1e00>;
					slew-rate = <0x01>;
				};
			};

			cam1@3 {
				linux,phandle = <0x29>;
				phandle = <0x29>;

				pins_cmd_dat {
					output-high;
					pins = <0x1600>;
					slew-rate = <0x01>;
				};
			};

			camdefault {
				linux,phandle = <0x21>;
				phandle = <0x21>;
			};

			camera_pins_cam0_mclk_off {
				linux,phandle = <0x2b>;
				phandle = <0x2b>;

				pins_cmd_dat {
					pins = <0x7e00>;
				};
			};

			camera_pins_cam0_mclk_on {
				linux,phandle = <0x2a>;
				phandle = <0x2a>;

				pins_cmd_dat {
					pins = <0x7e01>;
				};
			};

			camera_pins_cam1_mclk_off {
				linux,phandle = <0x2d>;
				phandle = <0x2d>;

				pins_cmd_dat {
					pins = <0x7e00>;
				};
			};

			camera_pins_cam1_mclk_on {
				linux,phandle = <0x2c>;
				phandle = <0x2c>;

				pins_cmd_dat {
					pins = <0x7e01>;
				};
			};
		};
	};

	fragment@21 {
		target = <0xffffffff>;

		__overlay__ {
			pinctrl-0 = <0x21>;
			pinctrl-1 = <0x22>;
			pinctrl-10 = <0x2b>;
			pinctrl-11 = <0x2c>;
			pinctrl-12 = <0x2d>;
			pinctrl-2 = <0x23>;
			pinctrl-3 = <0x24>;
			pinctrl-4 = <0x25>;
			pinctrl-5 = <0x26>;
			pinctrl-6 = <0x27>;
			pinctrl-7 = <0x28>;
			pinctrl-8 = <0x29>;
			pinctrl-9 = <0x2a>;
			pinctrl-names = "default\0cam0_rst0\0cam0_rst1\0cam0_pdn0\0cam0_pdn1\0cam1_rst0\0cam1_rst1\0cam1_pdn0\0cam1_pdn1\0cam0_mclk_on\0cam0_mclk_off\0cam1_mclk_on\0cam1_mclk_off";
			status = "okay";
		};
	};

	fragment@22 {
		target = <0xffffffff>;

		__overlay__ {

			aw3644default {
				linux,phandle = <0x2e>;
				phandle = <0x2e>;
			};

			hwen_high {
				linux,phandle = <0x2f>;
				phandle = <0x2f>;

				pins_cmd_dat {
					output-high;
					pins = <0x1600>;
					slew-rate = <0x01>;
				};
			};

			hwen_low {
				linux,phandle = <0x30>;
				phandle = <0x30>;

				pins_cmd_dat {
					output-low;
					pins = <0x1600>;
					slew-rate = <0x01>;
				};
			};
		};
	};

	fragment@23 {
		target = <0xffffffff>;

		__overlay__ {
			pinctrl-0 = <0x2e>;
			pinctrl-1 = <0x2f>;
			pinctrl-2 = <0x30>;
			pinctrl-names = "aw3644default\0hwen_high\0hwen_low";
			status = "okay";
		};
	};

	fragment@24 {
		target = <0xffffffff>;

		__overlay__ {

			dio5644default {
				linux,phandle = <0x31>;
				phandle = <0x31>;
			};

			hwen_high {
				linux,phandle = <0x32>;
				phandle = <0x32>;

				pins_cmd_dat {
					output-high;
					pins = <0x3500>;
					slew-rate = <0x01>;
				};
			};

			hwen_low {
				linux,phandle = <0x33>;
				phandle = <0x33>;

				pins_cmd_dat {
					output-low;
					pins = <0x3500>;
					slew-rate = <0x01>;
				};
			};
		};
	};

	fragment@25 {
		target = <0xffffffff>;

		__overlay__ {
			pinctrl-0 = <0x31>;
			pinctrl-1 = <0x32>;
			pinctrl-2 = <0x33>;
			pinctrl-names = "dio5644default\0hwen_high\0hwen_low";
			status = "okay";
		};
	};

	fragment@26 {
		target = <0xffffffff>;

		__overlay__ {

			cam_cal_drv_s5k3l6_eeprom {
				compatible = "mediatek,CAM_CAL_DRV2";
				reg = <0x51>;
			};

			cam_cal_drv_s5k3l8_eeprom@50 {
				compatible = "mediatek,cam_cal_drv_s5k3l8_eeprom";
				reg = <0x50>;
			};
		};
	};

	fragment@27 {
		target = <0xffffffff>;

		__overlay__ {
			extamp_gpio = <0xffffffff 0x06 0x00>;
			extamp_mode = <0x03>;
			extamp_speech_mode = <0x03>;
			pinctrl-0 = <0x34>;
			pinctrl-1 = <0x35>;
			pinctrl-2 = <0x36>;
			pinctrl-3 = <0x37>;
			pinctrl-4 = <0x38>;
			pinctrl-5 = <0x39>;
			pinctrl-names = "aud_dat_mosi_off\0aud_dat_mosi_on\0aud_dat_miso_off\0aud_dat_miso_on\0extamp-pullhigh\0extamp-pulllow";
			status = "okay";
		};
	};

	fragment@28 {
		target = <0xffffffff>;

		__overlay__ {

			aud_dat_miso_off {
				linux,phandle = <0x36>;
				phandle = <0x36>;

				pins_cmd1_dat {
					bias-disable;
					input-enable;
					pins = <0x4300>;
					slew-rate = <0x00>;
				};

				pins_cmd2_dat {
					bias-disable;
					input-enable;
					pins = <0x4400>;
					slew-rate = <0x00>;
				};
			};

			aud_dat_miso_on {
				linux,phandle = <0x37>;
				phandle = <0x37>;

				pins_cmd1_dat {
					pins = <0x4301>;
				};

				pins_cmd2_dat {
					pins = <0x4401>;
				};
			};

			aud_dat_mosi_off {
				linux,phandle = <0x34>;
				phandle = <0x34>;

				pins_cmd1_dat {
					bias-disable;
					input-enable;
					pins = <0x3f00>;
					slew-rate = <0x00>;
				};

				pins_cmd2_dat {
					bias-disable;
					input-enable;
					pins = <0x4000>;
					slew-rate = <0x00>;
				};
			};

			aud_dat_mosi_on {
				linux,phandle = <0x35>;
				phandle = <0x35>;

				pins_cmd1_dat {
					pins = <0x3f01>;
				};

				pins_cmd2_dat {
					pins = <0x4001>;
				};
			};

			audexamphigh {
				linux,phandle = <0x38>;
				phandle = <0x38>;

				pins_cmd_dat {
					output-high;
					pins = <0x600>;
					slew-rate = <0x01>;
				};
			};

			audexamplow {
				linux,phandle = <0x39>;
				phandle = <0x39>;

				pins_cmd_dat {
					output-low;
					pins = <0x600>;
					slew-rate = <0x01>;
				};
			};
		};
	};

	fragment@29 {
		target = <0xffffffff>;

		__overlay__ {

			adc_channel@ {
				compatible = "mediatek,adc_channel";
				mediatek,adc_fdd_rf_params_dynamic_custom_ch = <0x0c>;
				mediatek,temperature0 = <0x00>;
				mediatek,temperature1 = <0x01>;
				status = "okay";
			};
		};
	};

	fragment@3 {
		target = <0xffffffff>;

		__overlay__ {

			gyrodefaultcfg {
				linux,phandle = <0x45>;
				phandle = <0x45>;
			};

			gyropincfg {
				linux,phandle = <0x44>;
				phandle = <0x44>;

				pins_cmd_dat {
				};
			};
		};
	};

	fragment@30 {
		target = <0xffffffff>;

		__overlay__ {
			mediatek,clkbuf-config = <0x02 0x01 0x01 0x02 0x00 0x00 0x00>;
			mediatek,clkbuf-driving-current = <0xffffffff 0xffffffff 0xffffffff 0xffffffff 0xffffffff 0xffffffff 0xffffffff>;
			mediatek,clkbuf-quantity = <0x07>;
			status = "okay";
		};
	};

	fragment@31 {
		target = <0xffffffff>;

		__overlay__ {
			#address-cells = <0x01>;
			#size-cells = <0x00>;
			clock-frequency = <0x61a80>;
			mediatek,use-open-drain;

			cap_touch@38 {
				compatible = "mediatek,cap_touch";
				linux,phandle = <0x46>;
				phandle = <0x46>;
				reg = <0x38>;
				status = "okay";
			};
		};
	};

	fragment@32 {
		target = <0xffffffff>;

		__overlay__ {
			#address-cells = <0x01>;
			#size-cells = <0x00>;
			clock-frequency = <0x61a80>;
			mediatek,use-open-drain;

			sw_charger@6a {
				compatible = "mediatek,sw_charger";
				linux,phandle = <0x47>;
				phandle = <0x47>;
				reg = <0x6a>;
				status = "okay";
			};
		};
	};

	fragment@33 {
		target = <0xffffffff>;

		__overlay__ {
			#address-cells = <0x01>;
			#size-cells = <0x00>;
			clock-frequency = <0x61a80>;
			mediatek,use-open-drain;

			camera_main@10 {
				compatible = "mediatek,camera_main";
				linux,phandle = <0x48>;
				phandle = <0x48>;
				reg = <0x10>;
				status = "okay";
			};

			camera_main_af@0c {
				compatible = "mediatek,camera_main_af";
				linux,phandle = <0x49>;
				phandle = <0x49>;
				reg = <0x0c>;
				status = "okay";
			};

			camera_sub@37 {
				compatible = "mediatek,camera_sub";
				linux,phandle = <0x4a>;
				phandle = <0x4a>;
				reg = <0x37>;
				status = "okay";
			};
		};
	};

	fragment@34 {
		target = <0xffffffff>;

		__overlay__ {
			#address-cells = <0x01>;
			#size-cells = <0x00>;
			clock-frequency = <0x61a80>;
			mediatek,use-open-drain;

			i2c_lcd_bias@3e {
				compatible = "mediatek,i2c_lcd_bias";
				linux,phandle = <0x4b>;
				phandle = <0x4b>;
				reg = <0x3e>;
				status = "okay";
			};

			nfc@08 {
				compatible = "mediatek,nfc";
				linux,phandle = <0x4d>;
				phandle = <0x4d>;
				reg = <0x08>;
				status = "okay";
			};

			strobe_main@63 {
				compatible = "mediatek,strobe_main";
				linux,phandle = <0x4c>;
				phandle = <0x4c>;
				reg = <0x63>;
				status = "okay";
			};
		};
	};

	fragment@35 {
		target = <0xffffffff>;

		__overlay__ {
			#address-cells = <0x01>;
			#size-cells = <0x00>;
			clock-frequency = <0x61a80>;
			mediatek,use-open-drain;
		};
	};

	fragment@36 {
		target = <0xffffffff>;

		__overlay__ {
			#address-cells = <0x01>;
			#size-cells = <0x00>;
			clock-frequency = <0x61a80>;
			mediatek,use-open-drain;
		};
	};

	fragment@37 {
		target = <0xffffffff>;

		__overlay__ {
			GPIO_FDD_BAND_SUPPORT_DETECT_1ST_PIN = <0xffffffff 0x5a 0x00>;
			GPIO_FDD_BAND_SUPPORT_DETECT_2ND_PIN = <0xffffffff 0x5b 0x00>;
			GPIO_FDD_BAND_SUPPORT_DETECT_3RD_PIN = <0xffffffff 0x70 0x00>;
			GPIO_SIM1_HOT_PLUG = <0xffffffff 0x23 0x00>;
			GPIO_SIM1_SCLK = <0xffffffff 0x4d 0x00>;
			GPIO_SIM1_SIO = <0xffffffff 0x4f 0x00>;
			GPIO_SIM1_SRST = <0xffffffff 0x4e 0x00>;
			GPIO_SIM2_HOT_PLUG = <0xffffffff 0x24 0x00>;
			GPIO_SIM2_SCLK = <0xffffffff 0x50 0x00>;
			GPIO_SIM2_SIO = <0xffffffff 0x52 0x00>;
			GPIO_SIM2_SRST = <0xffffffff 0x51 0x00>;
		};
	};

	fragment@38 {
		target = <0xffffffff>;

		__overlay__ {
			interrupt-parent = <0xffffffff>;
			interrupts = <0x01 0x08 0x01 0x00>;
			status = "okay";
		};
	};

	fragment@39 {
		target = <0xffffffff>;

		__overlay__ {
			deb-gpios = <0xffffffff 0x0e 0x00>;
			debounce = <0x3e8>;
			interrupt-parent = <0xffffffff>;
			interrupts = <0x0e 0x08 0x0e 0x00>;
			status = "okay";
		};
	};

	fragment@4 {
		target = <0xffffffff>;

		__overlay__ {

			alspsdefaultcfg {
				linux,phandle = <0x06>;
				phandle = <0x06>;
			};

			alspspincfg {
				linux,phandle = <0x07>;
				phandle = <0x07>;

				pins_cmd_dat {
					bias-pull-up = <0x65>;
					pins = <0x500>;
					slew-rate = <0x00>;
					status = "okay";
				};
			};
		};
	};

	fragment@40 {
		target = <0xffffffff>;

		__overlay__ {
			interrupt-parent = <0xffffffff>;
			interrupts = <0x54 0x01 0x54 0x01>;
			status = "okay";
		};
	};

	fragment@41 {
		target = <0xffffffff>;

		__overlay__ {
			interrupt-parent = <0xffffffff>;
			interrupts = <0xb6 0x04 0x3a 0x01>;
			status = "okay";
		};
	};

	fragment@42 {
		target = <0xffffffff>;

		__overlay__ {
			compatible = "mediatek,md1_sim1_hot_plug_eint-eint";
			debounce = <0x00 0x186a0>;
			dedicated = <0x00 0x00>;
			interrupts = <0x00 0x04>;
			sockettype = <0x00 0x01>;
			src_pin = <0x00 0x01>;
			status = "okay";
		};
	};

	fragment@43 {
		target = <0xffffffff>;

		__overlay__ {
			compatible = "mediatek,md1_sim2_hot_plug_eint-eint";
			debounce = <0x01 0x186a0>;
			dedicated = <0x01 0x00>;
			interrupts = <0x01 0x04>;
			sockettype = <0x01 0x01>;
			src_pin = <0x01 0x02>;
			status = "okay";
		};
	};

	fragment@44 {
		target = <0xffffffff>;

		__overlay__ {
			regulator-default-on = <0x01>;
			regulator-name = "vcama";
			status = "okay";
		};
	};

	fragment@45 {
		target = <0xffffffff>;

		__overlay__ {
			regulator-default-on = <0x01>;
			regulator-name = "vsim1";
			status = "okay";
		};
	};

	fragment@46 {
		target = <0xffffffff>;

		__overlay__ {
			regulator-default-on = <0x01>;
			regulator-name = "vsim2";
			status = "okay";
		};
	};

	fragment@47 {
		target = <0xffffffff>;

		__overlay__ {
			regulator-default-on = <0x01>;
			regulator-name = "vcamd";
			status = "okay";
		};
	};

	fragment@48 {
		target = <0xffffffff>;

		__overlay__ {
			regulator-default-on = <0x01>;
			regulator-name = "vcamio";
			status = "okay";
		};
	};

	fragment@49 {
		target = <0xffffffff>;

		__overlay__ {
			regulator-default-on = <0x01>;
			regulator-name = "vldo28";
			status = "okay";
		};
	};

	fragment@5 {
		target = <0xffffffff>;

		__overlay__ {
			#address-cells = <0x01>;
			#size-cells = <0x00>;

			fingerprint@0 {
				compatible = "sunwave-fp";
				reg = <0x00>;
				spi-max-frequency = <0x7a1200>;
				status = "okay";
			};
		};
	};

	fragment@50 {
		target = <0xffffffff>;

		__overlay__ {
			status = "okay";
			vcama-supply = <0xffffffff>;
			vcama_sub-supply = <0xffffffff>;
			vcamaf-supply = <0xffffffff>;
			vcamd-supply = <0xffffffff>;
			vcamd_sub-supply = <0xffffffff>;
			vcamio-supply = <0xffffffff>;
			vcamio_sub-supply = <0xffffffff>;
		};
	};

	fragment@51 {
		target = <0xffffffff>;

		__overlay__ {
			status = "okay";
			vtouch-supply = <0xffffffff>;
		};
	};

	fragment@52 {
		target = <0xffffffff>;

		__overlay__ {
			mediatek,kpd-hw-dl-key0 = <0x00>;
			mediatek,kpd-hw-dl-key1 = <0x01>;
			mediatek,kpd-hw-dl-key2 = <0x08>;
			mediatek,kpd-hw-factory-key = <0x01>;
			mediatek,kpd-hw-init-map = <0x73 0x72 0x00 0x00 0x00 0x00 0x00 0x00 0x00 0x00 0x00 0x00 0x00 0x00 0x00 0x00 0x00 0x00 0x00 0x00 0x00 0x00 0x00 0x00 0x00 0x00 0x00 0x00 0x00 0x00 0x00 0x00 0x00 0x00 0x00 0x00 0x00 0x00 0x00 0x00 0x00 0x00 0x00 0x00 0x00 0x00 0x00 0x00 0x00 0x00 0x00 0x00 0x00 0x00 0x00 0x00 0x00 0x00 0x00 0x00 0x00 0x00 0x00 0x00 0x00 0x00 0x00 0x00 0x00 0x00 0x00 0x00>;
			mediatek,kpd-hw-map-num = <0x48>;
			mediatek,kpd-hw-pwrkey = <0x08>;
			mediatek,kpd-hw-recovery-key = <0x00>;
			mediatek,kpd-key-debounce = <0x400>;
			mediatek,kpd-pwkey-gpio-din = <0x00>;
			mediatek,kpd-pwrkey-eint-gpio = <0x00>;
			mediatek,kpd-sw-pwrkey = <0x74>;
			mediatek,kpd-use-extend-type = <0x00>;
			status = "okay";
		};
	};

	fragment@6 {
		target = <0xffffffff>;

		__overlay__ {

			fingerprint_default {
				linux,phandle = <0x01>;
				phandle = <0x01>;
			};

			gpio8_eint {
				linux,phandle = <0x02>;
				phandle = <0x02>;

				pins_cmd_dat {
					bias-disable;
					pins = <0x800>;
					slew-rate = <0x00>;
				};
			};

			gpio8_eint_pull_down {
				linux,phandle = <0x03>;
				phandle = <0x03>;

				pins_cmd_dat {
					bias-pull-down = <0x00>;
					output-low;
					pins = <0x800>;
					slew-rate = <0x00>;
				};
			};

			rst_out_one {
				linux,phandle = <0x04>;
				phandle = <0x04>;

				pins_cmd_dat {
					bias-disable;
					output-high;
					pins = <0x300>;
					slew-rate = <0x01>;
				};
			};

			rst_out_zero {
				linux,phandle = <0x05>;
				phandle = <0x05>;

				pins_cmd_dat {
					bias-disable;
					output-low;
					pins = <0x300>;
					slew-rate = <0x01>;
				};
			};
		};
	};

	fragment@7 {
		target = <0xffffffff>;

		__overlay__ {

			lcd_bias_enn0_gpio {
				linux,phandle = <0x0e>;
				phandle = <0x0e>;

				pins_cmd_dat {
					output-low;
					pins = <0x1200>;
					slew-rate = <0x01>;
				};
			};

			lcd_bias_enn1_gpio {
				linux,phandle = <0x0f>;
				phandle = <0x0f>;

				pins_cmd_dat {
					output-high;
					pins = <0x1200>;
					slew-rate = <0x01>;
				};
			};

			lcd_bias_enp0_gpio {
				linux,phandle = <0x0c>;
				phandle = <0x0c>;

				pins_cmd_dat {
					output-low;
					pins = <0x1300>;
					slew-rate = <0x01>;
				};
			};

			lcd_bias_enp1_gpio {
				linux,phandle = <0x0d>;
				phandle = <0x0d>;

				pins_cmd_dat {
					output-high;
					pins = <0x1300>;
					slew-rate = <0x01>;
				};
			};

			lcm_rst_out0_gpio {
				linux,phandle = <0x0a>;
				phandle = <0x0a>;

				pins_cmd_dat {
					output-low;
					pins = <0x5300>;
					slew-rate = <0x01>;
				};
			};

			lcm_rst_out1_gpio {
				linux,phandle = <0x0b>;
				phandle = <0x0b>;

				pins_cmd_dat {
					output-high;
					pins = <0x5300>;
					slew-rate = <0x01>;
				};
			};

			mode_te_gpio {
				linux,phandle = <0x08>;
				phandle = <0x08>;

				pins_cmd_dat {
					pins = <0x5401>;
				};
			};

			mode_te_te {
				linux,phandle = <0x09>;
				phandle = <0x09>;

				pins_cmd_dat {
					pins = <0x5401>;
				};
			};
		};
	};

	fragment@8 {
		target = <0xffffffff>;

		__overlay__ {
			pinctrl-0 = <0x08>;
			pinctrl-1 = <0x09>;
			pinctrl-2 = <0x0a>;
			pinctrl-3 = <0x0b>;
			pinctrl-4 = <0x0c>;
			pinctrl-5 = <0x0d>;
			pinctrl-6 = <0x0e>;
			pinctrl-7 = <0x0f>;
			pinctrl-names = "mode_te_gpio\0mode_te_te\0lcm_rst_out0_gpio\0lcm_rst_out1_gpio\0lcd_bias_enp0_gpio\0lcd_bias_enp1_gpio\0lcd_bias_enn0_gpio\0lcd_bias_enn1_gpio";
			status = "okay";
		};
	};

	fragment@9 {
		target = <0xffffffff>;

		__overlay__ {
			accdet-mic-mode = <0x02>;
			accdet-mic-vol = <0x06>;
			accdet-plugout-debounce = <0x01>;
			headset-eint-level-pol = <0x08>;
			headset-four-key-threshold = <0x00 0x3a 0x79 0xc0 0x190>;
			headset-mode-setting = <0x500 0x500 0x01 0x1f0 0x800 0x800 0x20 0x44>;
			headset-three-key-threshold = <0x00 0x50 0xdc 0x190>;
			headset-three-key-threshold-CDD = <0x00 0xb2 0x11b 0x258>;
			status = "okay";
		};
	};
};
